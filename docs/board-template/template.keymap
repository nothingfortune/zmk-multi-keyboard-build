/*
 * Copyright (c) 2020 The ZMK Contributors
 * Copyright (c) 2025 Innaworks Development Limited, trading as MoErgo
 *
 * SPDX-License-Identifier: MIT
 */


/* THIS FILE WAS GENERATED BY GO60 LAYOUT EDITOR
 *
 * This file was generated automatically. You may or may not want to
 * edit it directly.
 */

#include <behaviors.dtsi>

/* Include all behavior includes needed */

#include <dt-bindings/zmk/outputs.h>
#include <dt-bindings/zmk/keys.h>
#include <dt-bindings/zmk/bt.h>
#include <dt-bindings/zmk/rgb.h>

#include <input/processors.dtsi>
#include <dt-bindings/zmk/input_transform.h>
#include <zephyr/dt-bindings/input/input-event-codes.h>

/* On demand includes */
#include <dt-bindings/zmk/input_transform.h>
#include <dt-bindings/zmk/pointing.h>
#include <input/processors.dtsi>

/* ------------------------------------------------------------------ */
/*                           Shared lib                               */
/*                                                                    */
/* ------------------------------------------------------------------ */

#include <zmk-custom-functions-lib/shared/autoshift.dtsi>
#include <zmk-custom-functions-lib/shared/behaviors.dtsi>
#include <zmk-custom-functions-lib/shared/capsword.dtsi>
#include <zmk-custom-functions-lib/shared/layers.dtsi>
#include <zmk-custom-functions-lib/shared/macros.dtsi>
#include <zmk-custom-functions-lib/shared/modMorphs.dtsi>


/* ------------------------------------------------------------------ */
/*                           Home Row Mods                            */
/*                                                                    */
/* ------------------------------------------------------------------ */


#include <zmk-custom-functions-lib/shared/homeRowMods/hrm_behaviors.dtsi>
#include <zmk-custom-functions-lib/shared/homeRowMods/hrm_macros.dtsi>
#include <zmk-custom-functions-lib/shared/homeRowMods/hrm_timings.dtsi>


/* ------------------------------------------------------------------ */
/*                           Combos                                   */
/*                                                                    */
/* ------------------------------------------------------------------ */

#include <zmk-custom-functions-lib/shared/combos/combos_common.dtsi>
#include <zmk-custom-functions-lib/shared/combos/combos_fkeys.dtsi>

/* ------------------------------------------------------------------ */

#pragma once

#define ZMK_HELPER_STRINGIFY(x) #x

// Preprocessor mechanism to overload macros, cf. https://stackoverflow.com/a/27051616/6114651
#define VARGS_(_10, _9, _8, _7, _6, _5, _4, _3, _2, _1, N, ...) N
#define VARGS(...) VARGS_(__VA_ARGS__, 10, 9, 8, 7, 6, 5, 4, 3, 2, 1, 0)
#define CONCAT_(a, b) a##b
#define CONCAT(a, b) CONCAT_(a, b)

#define ZMK_BEHAVIOR_CORE_tap_dance  \
    compatible = "zmk,behavior-tap-dance"; \
    #binding-cells = <0>

#define ZMK_BEHAVIOR(name, type, ...) \
    name: name { \
        ZMK_BEHAVIOR_CORE_ ## type; \
        __VA_ARGS__ \
    };

#define ZMK_TAP_DANCE(name, ...) \
    ZMK_BEHAVIOR(name, tap_dance, __VA_ARGS__)

#define ZMK_TD_LAYER(name, layer) \
    ZMK_TAP_DANCE(name, \
        tapping-term-ms = <200>; \
        bindings = <&mo layer>, <&to layer>; \
)
