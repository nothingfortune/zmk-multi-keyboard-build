/* slicemk — LAYER_Symbol (row-interleaved; shared positions synced from boards/go60/layers/symbol.dtsi; bindings preserved) */

        LAYER_Symbol {
            bindings = <

/* ── Special top key (slicemk-only) ──────────────────────────────────────────────────────────────────────────────────────────────────────────────────────────────────────────────────────────────────────────────────────────────────────────────────────────────────────────────────── */
/* │                 ---                 │ */
/* |-------------------------------------| */

    &none

/* ── Row 1 ───────────────────────────────────────────────────────────────────────────────────────────────────────────────────────────────────────────────────────────────────────────────────────────────────────────────────────────────────────────────────────────────────────────── */
/* │                 ---                 │ │                 ---                 │ │                 ---                 │ │                 ---                 │ │                 ---                 │ │                 ---                 │ │                 ---                 │ │                 ---                 │ │                 ---                 │ │                 ---                 │ │                 ---                 │ │                 ---                 │ │                 ---                 │ │                 ---                 │ */
/* |-------------------------------------| |-------------------------------------| |-------------------------------------| |-------------------------------------| |-------------------------------------| |-------------------------------------| |-------------------------------------| |-------------------------------------| |-------------------------------------| |-------------------------------------| |-------------------------------------| |-------------------------------------| |-------------------------------------| |-------------------------------------| */

    &none                                    &none                                   &none                                   &none                                    &none                                    &none                                                                         &trans                                  &trans                                  &none                                   &none                                   &none                                     &none                                   &none                                    &none

/* ── Row 2 ───────────────────────────────────────────────────────────────────────────────────────────────────────────────────────────────────────────────────────────────────────────────────────────────────────────────────────────────────────────────────────────────────────────── */
/* │                 ---                 │ │                  ~                  │ │                  $                  │ │                  #                  │ │                  ^                  │ │                 ---                 │ │            C_PLAY_PAUSE             │ │              C_VOL_UP               │ │                 ---                 │ │                  _                  │ │                  @                  │ │                  %                  │ │                  `                  │ │                  :                  │ */
/* |-------------------------------------| |-------------------------------------| |-------------------------------------| |-------------------------------------| |-------------------------------------| |-------------------------------------| |-------------------------------------| |-------------------------------------| |-------------------------------------| |-------------------------------------| |-------------------------------------| |-------------------------------------| |-------------------------------------| |-------------------------------------| */

    &none                                   &kp TILDE                               &kp DOLLAR                                &kp HASH                                &kp CARET                                 &none                                                                         &kp C_PLAY_PAUSE                        &kp C_VOL_UP                            &none                                   &kp UNDER                               &kp AT                                  &kp PRCNT                               &kp GRAVE                               &kp COLON

/* ── Row 3 ───────────────────────────────────────────────────────────────────────────────────────────────────────────────────────────────────────────────────────────────────────────────────────────────────────────────────────────────────────────────────────────────────────────── */
/* │              CAPS WORD              │ │                  -                  │ │                  *                  │ │                  |                  │ │                  &                  │ │                 ---                 │                                        │                 ---                 │ │                 ()                  │ │                  )                  │ │                  +                  │ │                  =                  │ │                  '                  │ */
/* |-------------------------------------| |-------------------------------------| |-------------------------------------| |-------------------------------------| |-------------------------------------| |-------------------------------------|                                        |-------------------------------------| |-------------------------------------| |-------------------------------------| |-------------------------------------| |-------------------------------------| |-------------------------------------| */

    &caps_word                              &kp MINUS                               &kp STAR                                &kp PIPE                                &kp AMPS                                   &none                                                                          &none                                   &pair_paren                             &kp RPAR                                 &kp PLUS                                &kp EQUAL                                &kp SQT

/* ── Row 4 ───────────────────────────────────────────────────────────────────────────────────────────────────────────────────────────────────────────────────────────────────────────────────────────────────────────────────────────────────────────────────────────────────────────── */
/* │                MAGIC                │ │                  {                  │ │                  }                  │ │                 <>                  │ │                  >                  │ │                 ---                 │ │               C_NEXT                │ │              C_VOL_DN               │ │                 ---                 │ │                 []                  │ │                  ]                  │ │                  !                  │ │                  ?                  │ │                 ---                 │ */
/* |-------------------------------------| |-------------------------------------| |-------------------------------------| |-------------------------------------| |-------------------------------------| |-------------------------------------| |-------------------------------------| |-------------------------------------| |-------------------------------------| |-------------------------------------| |-------------------------------------| |-------------------------------------| |-------------------------------------| |-------------------------------------| */

    &none                                          &pair_brace                              &kp RBRC                                &pair_angle                               &kp GT                                    &none                                                                         &kp C_NEXT                              &kp C_VOL_DN                            &none                                   &pair_bracket                           &kp RBKT                                 &kp EXCL                                &kp QMARK                                 &trans

/* ── Row 5 ───────────────────────────────────────────────────────────────────────────────────────────────────────────────────────────────────────────────────────────────────────────────────────────────────────────────────────────────────────────────────────────────────────────── */
/* │                LCTRL                │ │                 ---                 │ │                 ---                 │ │                 ---                 │ │                RCLK                 │                                        │                LEFT                 │ │                 ---                 │ │                 ---                 │ │                 ---                 │ │                HYPER                │ */
/* |-------------------------------------| |-------------------------------------| |-------------------------------------| |-------------------------------------| |-------------------------------------|                                        |-------------------------------------| |-------------------------------------| |-------------------------------------| |-------------------------------------| |-------------------------------------| */

    &kp LCTRL                               &trans                                  &trans                                   &trans                                                                                                                                                                                                &mkp RCLK                                                                      &arrow_left LC(LEFT) LEFT               &trans                                  &trans                                  &trans                                  &hyper_key

/* ── Extra thumbs T4-T5 (slicemk-only) ───────────────────────────────────────────────────────────────────────────────────────────────────────────────────────────────────────────────────────────────────────────────────────────────────────────────────────────────────────────────── */
/* │                 DEL                 │ │                 ---                 │                                        │               C_NEXT                │ │                 DEL                 │ */
/* |-------------------------------------| |-------------------------------------|                                        |-------------------------------------| |-------------------------------------| */

    &kp DEL                                 &trans                                                                         &kp C_NEXT                              &kp DEL

/* ── Primary thumbs T1-T3 ────────────────────────────────────────────────────────────────────────────────────────────────────────────────────────────────────────────────────────────────────────────────────────────────────────────────────────────────────────────────────────────── */
/* │               TO BASE               │ │                 ---                 │ │                 ---                 │                                        │                 ---                 │ │                 ---                 │ │                 ---                 │ */
/* |-------------------------------------| |-------------------------------------| |-------------------------------------|                                        |-------------------------------------| |-------------------------------------| |-------------------------------------| */

    &to LAYER_Base                               &trans                                   &trans                                                                         &trans                                   &trans                                  &trans

/* ── Extra thumb T6 (slicemk-only) ───────────────────────────────────────────────────────────────────────────────────────────────────────────────────────────────────────────────────────────────────────────────────────────────────────────────────────────────────────────────────── */
/* │           Keypad/QUESTION           │                                        │            Symbol/PERIOD            │ */
/* |-------------------------------------|                                        |-------------------------------------| */

    &lt LAYER_Keypad QUESTION                                                      &lt LAYER_Symbol PERIOD

            >;
        };
