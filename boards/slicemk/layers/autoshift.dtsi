/* slicemk — LAYER_Autoshift (row-interleaved; shared positions synced from boards/go60/layers/autoshift.dtsi; bindings preserved) */

        LAYER_Autoshift {
            bindings = <

/* ── Special top key (slicemk-only) ──────────────────────────────────────────────────────────────────────────────────────────────────────────────────────────────────────────────────────────────────────────────────────────────────────────────────────────────────────────────────── */
/* │                 ---                 │ */
/* |-------------------------------------| */

    &none

/* ── Row 1 ───────────────────────────────────────────────────────────────────────────────────────────────────────────────────────────────────────────────────────────────────────────────────────────────────────────────────────────────────────────────────────────────────────────── */
/* │                ESC/`                │ │                 ---                 │ │                 ---                 │ │                 ---                 │ │                 ---                 │ │                 ---                 │ │                 ---                 │ │                 ---                 │ │                 ---                 │ │                 ---                 │ │                 ---                 │ │                 ---                 │ │                 ---                 │ │                 ---                 │ */
/* |-------------------------------------| |-------------------------------------| |-------------------------------------| |-------------------------------------| |-------------------------------------| |-------------------------------------| |-------------------------------------| |-------------------------------------| |-------------------------------------| |-------------------------------------| |-------------------------------------| |-------------------------------------| |-------------------------------------| |-------------------------------------| */

    &AS_v1_TKZ EQUAL                              &trans                                   &trans                                  &trans                                   &trans                                  &trans                                                                       &trans                                  &trans                                  &trans                                   &trans                                  &trans                                  &trans                                  &trans                                   &trans

/* ── Row 2 ───────────────────────────────────────────────────────────────────────────────────────────────────────────────────────────────────────────────────────────────────────────────────────────────────────────────────────────────────────────────────────────────────────────── */
/* │                 ---                 │ │                  Q                  │ │                  W                  │ │                  E                  │ │                  R                  │ │                  T                  │ │            C_PLAY_PAUSE             │ │              C_VOL_UP               │ │                  Y                  │ │                  U                  │ │                  I                  │ │                  O                  │ │                  P                  │ │                 ---                 │ */
/* |-------------------------------------| |-------------------------------------| |-------------------------------------| |-------------------------------------| |-------------------------------------| |-------------------------------------| |-------------------------------------| |-------------------------------------| |-------------------------------------| |-------------------------------------| |-------------------------------------| |-------------------------------------| |-------------------------------------| |-------------------------------------| */

    &trans                                  &AS_v1_TKZ Q                             &AS_v1_TKZ W                            &AS_v1_TKZ E                              &AS_v1_TKZ R                            &AS_v1_TKZ T                                                                  &kp C_PLAY_PAUSE                        &kp C_VOL_UP                            &AS_v1_TKZ Y                            &AS_v1_TKZ U                            &AS_v1_TKZ I                            &AS_v1_TKZ O                            &AS_v1_TKZ P                                 &trans

/* ── Row 3 ───────────────────────────────────────────────────────────────────────────────────────────────────────────────────────────────────────────────────────────────────────────────────────────────────────────────────────────────────────────────────────────────────────────── */
/* │                 ---                 │ │                  A                  │ │                  S                  │ │                  D                  │ │                  F                  │ │                  G                  │                                        │                  H                  │ │                  J                  │ │                  K                  │ │                  L                  │ │                  ;                  │ │                 ---                 │ */
/* |-------------------------------------| |-------------------------------------| |-------------------------------------| |-------------------------------------| |-------------------------------------| |-------------------------------------|                                        |-------------------------------------| |-------------------------------------| |-------------------------------------| |-------------------------------------| |-------------------------------------| |-------------------------------------| */

    &trans                                  &AS_v1_TKZ A                             &AS_v1_TKZ S                            &AS_v1_TKZ D                              &AS_v1_TKZ F                            &AS_v1_TKZ G                                                                   &AS_v1_TKZ H                            &AS_v1_TKZ J                            &AS_v1_TKZ K                            &AS_v1_TKZ L                            &AS_v1_TKZ SEMI                               &trans

/* ── Row 4 ───────────────────────────────────────────────────────────────────────────────────────────────────────────────────────────────────────────────────────────────────────────────────────────────────────────────────────────────────────────────────────────────────────────── */
/* │                MAGIC                │ │                  Z                  │ │                  X                  │ │                  C                  │ │                  V                  │ │                  B                  │ │               C_NEXT                │ │              C_VOL_DN               │ │                  N                  │ │                  M                  │ │                ,/<>                 │ │                  .                  │ │                  /                  │ │                 ---                 │ */
/* |-------------------------------------| |-------------------------------------| |-------------------------------------| |-------------------------------------| |-------------------------------------| |-------------------------------------| |-------------------------------------| |-------------------------------------| |-------------------------------------| |-------------------------------------| |-------------------------------------| |-------------------------------------| |-------------------------------------| |-------------------------------------| */

    &none                                          &AS_v1_TKZ Z                             &AS_v1_TKZ X                            &AS_v1_TKZ C                              &AS_v1_TKZ V                            &AS_v1_TKZ B                                                                  &kp C_NEXT                              &kp C_VOL_DN                            &AS_v1_TKZ N                            &AS_v1_TKZ M                            &AS_v1_TKZ COMMA                          &AS_v1_TKZ DOT                          &AS_v1_TKZ FSLH                               &trans

/* ── Row 5 ───────────────────────────────────────────────────────────────────────────────────────────────────────────────────────────────────────────────────────────────────────────────────────────────────────────────────────────────────────────────────────────────────────────── */
/* │                LCTRL                │ │                 ---                 │ │                 ---                 │ │                 ---                 │ │                RCLK                 │                                        │                LEFT                 │ │                 ---                 │ │                 ---                 │ │                 ---                 │ │                HYPER                │ */
/* |-------------------------------------| |-------------------------------------| |-------------------------------------| |-------------------------------------| |-------------------------------------|                                        |-------------------------------------| |-------------------------------------| |-------------------------------------| |-------------------------------------| |-------------------------------------| */

    &kp LCTRL                               &trans                                  &trans                                  &trans                                                                                                                                                                                                    &mkp RCLK                                                                      &arrow_left LC(LEFT) LEFT               &trans                                  &trans                                   &trans                                  &hyper_key

/* ── Extra thumbs T4-T5 (slicemk-only) ───────────────────────────────────────────────────────────────────────────────────────────────────────────────────────────────────────────────────────────────────────────────────────────────────────────────────────────────────────────────── */
/* │                 DEL                 │ │                 ---                 │                                        │               C_NEXT                │ │                 DEL                 │ */
/* |-------------------------------------| |-------------------------------------|                                        |-------------------------------------| |-------------------------------------| */

    &kp DEL                                 &trans                                                                         &kp C_NEXT                              &kp DEL

/* ── Primary thumbs T1-T3 ────────────────────────────────────────────────────────────────────────────────────────────────────────────────────────────────────────────────────────────────────────────────────────────────────────────────────────────────────────────────────────────── */
/* │                 ---                 │ │                 ---                 │ │                 ---                 │                                        │                 ---                 │ │                 ---                 │ │                 ---                 │ */
/* |-------------------------------------| |-------------------------------------| |-------------------------------------|                                        |-------------------------------------| |-------------------------------------| |-------------------------------------| */

    &trans                                     &trans                                  &trans                                                                         &trans                                  &trans                                  &trans

/* ── Extra thumb T6 (slicemk-only) ───────────────────────────────────────────────────────────────────────────────────────────────────────────────────────────────────────────────────────────────────────────────────────────────────────────────────────────────────────────────────── */
/* │           Keypad/QUESTION           │                                        │            Symbol/PERIOD            │ */
/* |-------------------------------------|                                        |-------------------------------------| */

    &lt LAYER_Keypad QUESTION                                                      &lt LAYER_Symbol PERIOD

            >;
        };
