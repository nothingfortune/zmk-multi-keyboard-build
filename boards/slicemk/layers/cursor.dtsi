/* slicemk — LAYER_Cursor (row-interleaved; shared positions synced from boards/go60/layers/cursor.dtsi; bindings preserved) */

        LAYER_Cursor {
            bindings = <

/* ── Special top key (slicemk-only) ──────────────────────────────────────────────────────────────────────────────────────────────────────────────────────────────────────────────────────────────────────────────────────────────────────────────────────────────────────────────────── */
/* │                 ---                 │ */
    &none
/* |-------------------------------------| */

/* ── Row 1 ───────────────────────────────────────────────────────────────────────────────────────────────────────────────────────────────────────────────────────────────────────────────────────────────────────────────────────────────────────────────────────────────────────────── */
/* │                 ---                 │ │                 ---                 │ │                 ---                 │ │                 ---                 │ │             RIGHT CLICK             │ │              SCROLL UP              │ │                 ---                 │ │                 ---                 │ │              SCROLL UP              │ │                 ---                 │ │                 ---                 │ │                 ---                 │ │                 ---                 │ │                 ---                 │ */
    &trans                                     &trans                                   &none                                   &trans                                  &mkp RCLK                                  &kp LG(PLUS)                                                               &trans                                  &trans                                  &msc SCRL_UP                                 &trans                                  &trans                                   &trans                                  &trans                                    &trans
/* |-------------------------------------| |-------------------------------------| |-------------------------------------| |-------------------------------------| |-------------------------------------| |-------------------------------------| |-------------------------------------| |-------------------------------------| |-------------------------------------| |-------------------------------------| |-------------------------------------| |-------------------------------------| |-------------------------------------| |-------------------------------------| */

/* ── Row 2 ───────────────────────────────────────────────────────────────────────────────────────────────────────────────────────────────────────────────────────────────────────────────────────────────────────────────────────────────────────────────────────────────────────────── */
/* │                 ---                 │ │                 ---                 │ │                 ---                 │ │              MOUSE UP               │ │             LEFT CLICK              │ │             SCROLL DOWN             │ │            C_PLAY_PAUSE             │ │              C_VOL_UP               │ │                 ---                 │ │                 ---                 │ │               MOVE UP               │ │                 ---                 │ │                 ---                 │ │                 ---                 │ */
    &trans                                     &trans                                   &none                                   &mmv MOVE_UP                             &mkp LCLK                                &kp LG(MINUS)                                                            &kp C_PLAY_PAUSE                        &kp C_VOL_UP                            &msc SCRL_DOWN                               &trans                                  &mmv MOVE_UP                               &trans                                  &trans                                    &trans
/* |-------------------------------------| |-------------------------------------| |-------------------------------------| |-------------------------------------| |-------------------------------------| |-------------------------------------| |-------------------------------------| |-------------------------------------| |-------------------------------------| |-------------------------------------| |-------------------------------------| |-------------------------------------| |-------------------------------------| |-------------------------------------| */

/* ── Row 3 ───────────────────────────────────────────────────────────────────────────────────────────────────────────────────────────────────────────────────────────────────────────────────────────────────────────────────────────────────────────────────────────────────────────── */
/* │                 ---                 │ │                 ---                 │ │             MOUSE LEFT              │ │             MOUSE DOWN              │ │             MOUSE RIGHT             │ │                 ---                 │                                        │                 ---                 │ │              MOVE LEFT              │ │              MOVE DOWN              │ │             MOVE RIGHT              │ │                 ---                 │ │                 ---                 │ */
    &trans                                     &none                                   &mmv MOVE_LEFT                           &mmv MOVE_DOWN                          &mmv MOVE_RIGHT                              &none                                                                          &trans                                  &mmv MOVE_LEFT                          &mmv MOVE_DOWN                          &mmv MOVE_RIGHT                             &trans                                     &trans
/* |-------------------------------------| |-------------------------------------| |-------------------------------------| |-------------------------------------| |-------------------------------------| |-------------------------------------|                                        |-------------------------------------| |-------------------------------------| |-------------------------------------| |-------------------------------------| |-------------------------------------| |-------------------------------------| */

/* ── Row 4 ───────────────────────────────────────────────────────────────────────────────────────────────────────────────────────────────────────────────────────────────────────────────────────────────────────────────────────────────────────────────────────────────────────────── */
/* │                 ---                 │ │                 ---                 │ │                 ---                 │ │              MOUSEFAST              │ │              MOUSEWARP              │ │              MOUSESLOW              │ │               C_NEXT                │ │              C_VOL_DN               │ │              MOUSESLOW              │ │              MOUSEWARP              │ │              MOUSEFAST              │ │                 ---                 │ │                 ---                 │ │                 ---                 │ */
    &none                                      &none                                   &none                                   &mo LAYER_MouseFast                     &mo LAYER_MouseWarp                     &mo LAYER_MouseSlow                                                         &kp C_NEXT                              &kp C_VOL_DN                            &mo LAYER_MouseSlow                     &mo LAYER_MouseWarp                     &mo LAYER_MouseFast                            &none                                   &trans                                     &trans
/* |-------------------------------------| |-------------------------------------| |-------------------------------------| |-------------------------------------| |-------------------------------------| |-------------------------------------| |-------------------------------------| |-------------------------------------| |-------------------------------------| |-------------------------------------| |-------------------------------------| |-------------------------------------| |-------------------------------------| |-------------------------------------| */

/* ── Row 5 ───────────────────────────────────────────────────────────────────────────────────────────────────────────────────────────────────────────────────────────────────────────────────────────────────────────────────────────────────────────────────────────────────────────── */
/* │                LCTRL                │ │                 ---                 │ │                 ---                 │ │                 ---                 │ │                RCLK                 │                                        │                LEFT                 │ │                 ---                 │ │                 ---                 │ │                 ---                 │ │                HYPER                │ */
    &kp LCTRL                               &trans                                  &trans                                  &trans                                                                                                                                                                                               &mkp RCLK                                                                      &arrow_left LC(LEFT) LEFT               &trans                                  &trans                                   &trans                                  &hyper_key
/* |-------------------------------------| |-------------------------------------| |-------------------------------------| |-------------------------------------| |-------------------------------------|                                        |-------------------------------------| |-------------------------------------| |-------------------------------------| |-------------------------------------| |-------------------------------------| */

/* ── Extra thumbs T4-T5 (slicemk-only) ───────────────────────────────────────────────────────────────────────────────────────────────────────────────────────────────────────────────────────────────────────────────────────────────────────────────────────────────────────────────── */
/* │                 DEL                 │ │                 ---                 │                                        │               C_NEXT                │ │                 DEL                 │ */
    &kp DEL                                 &trans                                                                         &kp C_NEXT                              &kp DEL
/* |-------------------------------------| |-------------------------------------|                                        |-------------------------------------| |-------------------------------------| */

/* ── Primary thumbs T1-T3 ────────────────────────────────────────────────────────────────────────────────────────────────────────────────────────────────────────────────────────────────────────────────────────────────────────────────────────────────────────────────────────────── */
/* │                 DEL                 │ │             RIGHT CLICK             │ │             LEFT MOUSE              │                                        │             LEFT MOUSE              │ │             RIGHT MOUSE             │ │                 ---                 │ */
    &kp DEL                                 &mkp RCLK                                 &mkp LCLK                                                                      &mkp LCLK                                &mkp RCLK                                  &trans
/* |-------------------------------------| |-------------------------------------| |-------------------------------------|                                        |-------------------------------------| |-------------------------------------| |-------------------------------------| */

/* ── Extra thumb T6 (slicemk-only) ───────────────────────────────────────────────────────────────────────────────────────────────────────────────────────────────────────────────────────────────────────────────────────────────────────────────────────────────────────────────────── */
/* │           Keypad/QUESTION           │                                        │            Symbol/PERIOD            │ */
    &lt LAYER_Keypad QUESTION                                                      &lt LAYER_Symbol PERIOD
/* |-------------------------------------|                                        |-------------------------------------| */

            >;
        };
