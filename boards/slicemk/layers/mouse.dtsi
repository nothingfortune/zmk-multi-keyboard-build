/* slicemk — LAYER_Mouse (row-interleaved; shared positions synced from boards/go60/layers/mouse.dtsi; bindings preserved) */

        LAYER_Mouse {
            bindings = <

/* ── Special top key (slicemk-only) ────────────────────── */
/* │                 ---                 │ */
/* |-------------------------------------| */
   &none

/* ── Row 1 ─────────────────────────────────────────────── */
/* │                 ESC                 │ │           Mission Control           │ │              SCROLL UP              │ │                 ---                 │ │             RIGHT CLOCK             │ │              ZOOM OUT               │ │                 ---                 │ │                 ---                 │ │                 ---                 │ │                 ---                 │ │                 ---                 │ │                 ---                 │ │           Mission Control           │ │             App Exposè              │ */
/* |-------------------------------------| |-------------------------------------| |-------------------------------------| |-------------------------------------| |-------------------------------------| |-------------------------------------| |-------------------------------------| |-------------------------------------| |-------------------------------------| |-------------------------------------| |-------------------------------------| |-------------------------------------| |-------------------------------------| |-------------------------------------| */
   &kp ESC                                &mac_mission_ctl                           &msc SCRL_UP                               &trans                                  &mkp RCLK                               &kp LG(MINUS)                                                                  &trans                                  &trans                                  &trans                                   &trans                                  &trans                                    &trans                                  &mac_mission_ctl                         &mac_app_expose

/* ── Row 2 ─────────────────────────────────────────────── */
/* │               Expose                │ │                 ---                 │ │             SCROLL DOWN             │ │              MOUSE UP               │ │             LEFT CLICK              │ │               ZOOM IN               │ │            C_PLAY_PAUSE             │ │              C_VOL_UP               │ │                 ---                 │ │                 ---                 │ │               MOVE UP               │ │                 ---                 │ │                 ---                 │ │                 ---                 │ */
/* |-------------------------------------| |-------------------------------------| |-------------------------------------| |-------------------------------------| |-------------------------------------| |-------------------------------------| |-------------------------------------| |-------------------------------------| |-------------------------------------| |-------------------------------------| |-------------------------------------| |-------------------------------------| |-------------------------------------| |-------------------------------------| */
   &mac_app_expose                                 &trans                                  &msc SCRL_DOWN                           &mmv MOVE_UP                             &mkp LCLK                               &kp LG(PLUS)                                                                   &kp C_PLAY_PAUSE                        &kp C_VOL_UP                            &trans                                   &trans                                  &mmv MOVE_UP                                &trans                                  &trans                                     &trans

/* ── Row 3 ─────────────────────────────────────────────── */
/* │                 ---                 │ │             SCROLL LEFT             │ │             MOUSE LEFT              │ │             MOUSE DOWN              │ │             MOUNT RIGHT             │ │            SCROLL RIGHT             │                                        │                 ---                 │ │              MOVE LEFT              │ │              MOVE DOWN              │ │             MOVE RIGHT              │ │                 ---                 │ │                 ---                 │ */
/* |-------------------------------------| |-------------------------------------| |-------------------------------------| |-------------------------------------| |-------------------------------------| |-------------------------------------|                                        |-------------------------------------| |-------------------------------------| |-------------------------------------| |-------------------------------------| |-------------------------------------| |-------------------------------------| */
   &trans                                 &msc SCRL_LEFT                          &mmv MOVE_LEFT                           &mmv MOVE_DOWN                          &mmv MOVE_RIGHT                          &msc SCRL_RIGHT                                                                 &trans                                  &mmv MOVE_LEFT                          &mmv MOVE_DOWN                            &mmv MOVE_RIGHT                             &trans                                     &trans

/* ── Row 4 ─────────────────────────────────────────────── */
/* │                 ---                 │ │             SCROLL DOWN             │ │              MOUSESLOW              │ │              MOUSEFAST              │ │              MOUSEWARP              │ │                 DEL                 │ │               C_NEXT                │ │              C_VOL_DN               │ │                 ---                 │ │              MOUSEWARP              │ │              MOUSEFAST              │ │              MOUSESLOW              │ │                 ---                 │ │                 ---                 │ */
/* |-------------------------------------| |-------------------------------------| |-------------------------------------| |-------------------------------------| |-------------------------------------| |-------------------------------------| |-------------------------------------| |-------------------------------------| |-------------------------------------| |-------------------------------------| |-------------------------------------| |-------------------------------------| |-------------------------------------| |-------------------------------------| */
   &none                                  &msc SCRL_DOWN                          &mo LAYER_MouseSlow                      &mo LAYER_MouseFast                     &mo LAYER_MouseWarp                           &kp DEL                                                                      &kp C_NEXT                              &kp C_VOL_DN                            &trans                                  &mo LAYER_MouseWarp                     &mo LAYER_MouseFast                     &mo LAYER_MouseSlow                            &trans                                     &trans

/* ── Row 5 ─────────────────────────────────────────────── */
/* │                LCTRL                │ │                 ---                 │ │                 ---                 │ │                 ---                 │ │                RCLK                 │                                        │                LEFT                 │ │                 ---                 │ │                 ---                 │ │                 ---                 │ │                HYPER                │ */
/* |-------------------------------------| |-------------------------------------| |-------------------------------------| |-------------------------------------| |-------------------------------------|                                        |-------------------------------------| |-------------------------------------| |-------------------------------------| |-------------------------------------| |-------------------------------------| */
   &kp LCTRL                              &trans                                  &trans                                  &trans                                                                                                                                                                                               &mkp RCLK                                                                      &arrow_left LC(LEFT) LEFT               &trans                                  &trans                                     &trans                                  &hyper_key

/* ── Extra thumbs T4-T5 (slicemk-only) ─────────────────── */
/* │                 DEL                 │ │                 ---                 │                                        │               C_NEXT                │ │                 DEL                 │ */
/* |-------------------------------------| |-------------------------------------|                                        |-------------------------------------| |-------------------------------------| */
   &kp DEL                                &trans                                                                         &kp C_NEXT                              &kp DEL

/* ── Primary thumbs T1-T3 ──────────────────────────────── */
/* │                 DEL                 │ │                 ---                 │ │                 DEL                 │                                        │             LEFT MOUSE              │ │                 ---                 │ │                 ---                 │ */
/* |-------------------------------------| |-------------------------------------| |-------------------------------------|                                        |-------------------------------------| |-------------------------------------| |-------------------------------------| */
   &kp DEL                                  &trans                                   &kp DEL                                                                        &mkp LCLK                                  &trans                                  &trans

/* ── Extra thumb T6 (slicemk-only) ─────────────────────── */
/* │           Keypad/QUESTION           │                                        │            Symbol/PERIOD            │ */
/* |-------------------------------------|                                        |-------------------------------------| */
   &lt LAYER_Keypad QUESTION                                                     &lt LAYER_Symbol PERIOD

            >;
        };
