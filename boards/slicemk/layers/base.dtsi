/* slicemk — LAYER_Base (row-interleaved; shared positions synced from boards/go60/layers/base.dtsi; bindings preserved) */

        LAYER_Base {
            bindings = <

/* ── Special top key (slicemk-only) ────────────────────────────────────────────────────────────────────────────────────────────────────────────────────────────────────────────────────────────────────────────────────────────────────────────────────────────────────────────────────────────────────────────────────────────── */
/* │                    ---                     │ */
    &none
/* |--------------------------------------------| */

/* ── Row 1 ─────────────────────────────────────────────────────────────────────────────────────────────────────────────────────────────────────────────────────────────────────────────────────────────────────────────────────────────────────────────────────────────────────────────────────────────────────────────────────── */
/* │                   ESC/`                    │ │                    1/!                     │ │                    2/@                     │ │                    3/#                     │ │                    4/$                     │ │                    5/%                     │ │                    ---                     │ │                    ---                     │ │                    6/^                     │ │                    7/&                     │ │                    8/*                     │ │                    9/()                    │ │                    0/)                     │ │                     {}                     │ */
    &gresc                                         &num_ht LS(N1) N1                              &num_ht LS(N2) N2                              &num_ht LS(N3) N3                              &num_ht LS(N4) N4                              &num_ht LS(N5) N5                                                            &trans                                         &trans                                         &num_ht LS(N6) N6                              &num_ht LS(N7) N7                              &num_ht LS(N8) N8                              &n9_paren                                      &num_ht LS(N0) N0                              &pair_brace
/* |--------------------------------------------| |--------------------------------------------| |--------------------------------------------| |--------------------------------------------| |--------------------------------------------| |--------------------------------------------| |--------------------------------------------| |--------------------------------------------| |--------------------------------------------| |--------------------------------------------| |--------------------------------------------| |--------------------------------------------| |--------------------------------------------| |--------------------------------------------| */

/* ── Row 2 ─────────────────────────────────────────────────────────────────────────────────────────────────────────────────────────────────────────────────────────────────────────────────────────────────────────────────────────────────────────────────────────────────────────────────────────────────────────────────────── */
/* │                    TAB                     │ │                     Q                      │ │                     W                      │ │                     E                      │ │                     R                      │ │                     T                      │ │                C_PLAY_PAUSE                │ │                  C_VOL_UP                  │ │                     Y                      │ │                     U                      │ │                     I                      │ │                     O                      │ │                     P                      │ │                     ()                     │ */
    &tab_hyper LS(LC(LA(LGUI))) TAB                       &kp Q                                          &kp W                                          &kp E                                          &kp R                                          &kp T                                                                          &kp C_PLAY_PAUSE                               &kp C_VOL_UP                                   &kp Y                                          &kp U                                          &kp I                                          &kp O                                          &kp P                                          &pair_paren
/* |--------------------------------------------| |--------------------------------------------| |--------------------------------------------| |--------------------------------------------| |--------------------------------------------| |--------------------------------------------| |--------------------------------------------| |--------------------------------------------| |--------------------------------------------| |--------------------------------------------| |--------------------------------------------| |--------------------------------------------| |--------------------------------------------| |--------------------------------------------| */

/* ── Row 3 ─────────────────────────────────────────────────────────────────────────────────────────────────────────────────────────────────────────────────────────────────────────────────────────────────────────────────────────────────────────────────────────────────────────────────────────────────────────────────────── */
/* │                 CAPS WORD                  │ │                GUI(hold)/A                 │ │                ALT(hold)/S                 │ │                CTRL(hold)/D                │ │               SHIFT(hold)/F                │ │                SYMB(hold)/G                │                                        │                SYMB(hold)/H                │ │               SHIFT(hold)/J                │ │                CTRL(hold)/K                │ │                ALT(hold)/L                 │ │                GUI(hold)/;                 │ │                     ""                     │ */
    &lshft_cw_td                                   &HRM_left_pinky_v1B_TKZ LGUI A                 &HRM_left_ring_v1B_TKZ LALT S                  &HRM_left_middy_v1B_TKZ LCTRL D                &HRM_left_index_v1B_TKZ LSHFT F                &HRMO_left_index_v1B_TKZ LAYER_Symbol_lh G                                            &HRMO_right_index_v1B_TKZ LAYER_Symbol_rh H    &HRM_right_index_v1B_TKZ RSHFT J               &HRM_right_middy_v1B_TKZ RCTRL K               &HRM_right_ring_v1B_TKZ LALT L                 &HRM_right_pinky_v1B_TKZ RGUI SEMI                    &dqt_pair
/* |--------------------------------------------| |--------------------------------------------| |--------------------------------------------| |--------------------------------------------| |--------------------------------------------| |--------------------------------------------|                                        |--------------------------------------------| |--------------------------------------------| |--------------------------------------------| |--------------------------------------------| |--------------------------------------------| |--------------------------------------------| */

/* ── Row 4 ─────────────────────────────────────────────────────────────────────────────────────────────────────────────────────────────────────────────────────────────────────────────────────────────────────────────────────────────────────────────────────────────────────────────────────────────────────────────────────── */
/* │                   MAGIC                    │ │                     Z                      │ │                     X                      │ │                     C                      │ │                     V                      │ │                     B                      │ │                   C_NEXT                   │ │                  C_VOL_DN                  │ │                     N                      │ │                     M                      │ │                    ,/<>                    │ │                     .                      │ │                     /                      │ │                   ENTER                    │ */
    &none                                               &kp Z                                          &kp X                                          &kp C                                          &HRMO_left_index_v1B_TKZ LAYER_Keypad V                 &kp B                                                                         &kp C_NEXT                                     &kp C_VOL_DN                                   &kp N                                          &HRMO_left_index_v1B_TKZ LAYER_Keypad M              &comma_angle                                   &kp DOT                                        &kp FSLH                                       &kp RET
/* |--------------------------------------------| |--------------------------------------------| |--------------------------------------------| |--------------------------------------------| |--------------------------------------------| |--------------------------------------------| |--------------------------------------------| |--------------------------------------------| |--------------------------------------------| |--------------------------------------------| |--------------------------------------------| |--------------------------------------------| |--------------------------------------------| |--------------------------------------------| */

/* ── Row 5 ─────────────────────────────────────────────────────────────────────────────────────────────────────────────────────────────────────────────────────────────────────────────────────────────────────────────────────────────────────────────────────────────────────────────────────────────────────────────────────── */
/* │                   LCTRL                    │ │                   LCTRL                    │ │                    LALT                    │ │                    CMD                     │ │                    RCLK                    │                                        │                    LEFT                    │ │               LEFT/WORD-LEFT               │ │                    DOWN                    │ │              RIGHT/WORD-RIGHT              │ │                   HYPER                    │ */
    &kp LCTRL                                      &kp LCTRL                                      &kp LALT                                       &kp LGUI                                                                                                                                              &mkp RCLK                                                                             &arrow_left LC(LEFT) LEFT                      &arrow_left LA(LEFT) LEFT                      &upDownArrows                                  &arrow_right LA(RIGHT) RIGHT                   &hyper_key
/* |--------------------------------------------| |--------------------------------------------| |--------------------------------------------| |--------------------------------------------| |--------------------------------------------|                                        |--------------------------------------------| |--------------------------------------------| |--------------------------------------------| |--------------------------------------------| |--------------------------------------------| */

/* ── Extra thumbs T4-T5 (slicemk-only) ─────────────────────────────────────────────────────────────────────────────────────────────────────────────────────────────────────────────────────────────────────────────────────────────────────────────────────────────────────────────────────────────────────────────────────────── */
/* │                    DEL                     │ │                    ---                     │                                        │                   C_NEXT                   │ │                    DEL                     │ */
    &kp DEL                                        &trans                                                                                &kp C_NEXT                                     &kp DEL
/* |--------------------------------------------| |--------------------------------------------|                                        |--------------------------------------------| |--------------------------------------------| */

/* ── Primary thumbs T1-T3 ──────────────────────────────────────────────────────────────────────────────────────────────────────────────────────────────────────────────────────────────────────────────────────────────────────────────────────────────────────────────────────────────────────────────────────────────────────── */
/* │              NAV(hold)/SPACE               │ │                   ENTER                    │ │                DEL(hold)/?                 │                                        │                DEL(hold)/.                 │ │               BSPC/DEL-WORD                │ │              NAV(hold)/SPACE               │ */
    &thumb_v2_TKZ LAYER_Cursor SPACE               &thumb_v2_TKZ LAYER_Keypad RET                 &thumb_v2_TKZ DEL QMARK                                                               &thumb_v2_TKZ DEL PERIOD                       &bspc_word LA(BSPC) BSPC                       &thumb_v2_TKZ LAYER_Keypad SPACE
/* |--------------------------------------------| |--------------------------------------------| |--------------------------------------------|                                        |--------------------------------------------| |--------------------------------------------| |--------------------------------------------| */

/* ── Extra thumb T6 (slicemk-only) ─────────────────────────────────────────────────────────────────────────────────────────────────────────────────────────────────────────────────────────────────────────────────────────────────────────────────────────────────────────────────────────────────────────────────────────────── */
/* │              Keypad/QUESTION               │                                        │               Symbol/PERIOD                │ */
    &lt LAYER_Keypad QUESTION                                                             &lt LAYER_Symbol PERIOD
/* |--------------------------------------------|                                        |--------------------------------------------| */

            >;
        };
