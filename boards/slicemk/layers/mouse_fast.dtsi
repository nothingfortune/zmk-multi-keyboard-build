/* slicemk — LAYER_MouseFast (row-interleaved; shared positions synced from boards/go60/layers/mouse_fast.dtsi; bindings preserved) */

        LAYER_MouseFast {
            bindings = <

/* ── Special top key (slicemk-only) ────────────────────── */
/* │                 ---                 │ */
/* |-------------------------------------| */
   &none

/* ── Row 1 ─────────────────────────────────────────────── */
/* │                 ---                 │ │                 ---                 │ │                 ---                 │ │                 ---                 │ │                 ---                 │ │                 ---                 │ │                 ---                 │ │                 ---                 │ │                 ---                 │ │                 ---                 │ │                 ---                 │ │                 ---                 │ │                 ---                 │ │                 ---                 │ */
/* |-------------------------------------| |-------------------------------------| |-------------------------------------| |-------------------------------------| |-------------------------------------| |-------------------------------------| |-------------------------------------| |-------------------------------------| |-------------------------------------| |-------------------------------------| |-------------------------------------| |-------------------------------------| |-------------------------------------| |-------------------------------------| */
   &trans                                     &trans                                  &trans                                  &trans                                  &trans                                  &trans                                                                       &trans                                  &trans                                  &trans                                    &trans                                  &trans                                   &trans                                  &trans                                     &trans

/* ── Row 2 ─────────────────────────────────────────────── */
/* │                 ---                 │ │                 ---                 │ │                 ---                 │ │                 ---                 │ │                 ---                 │ │                 ---                 │ │            C_PLAY_PAUSE             │ │              C_VOL_UP               │ │                 ---                 │ │                 ---                 │ │                 ---                 │ │                 ---                 │ │                 ---                 │ │                 ---                 │ */
/* |-------------------------------------| |-------------------------------------| |-------------------------------------| |-------------------------------------| |-------------------------------------| |-------------------------------------| |-------------------------------------| |-------------------------------------| |-------------------------------------| |-------------------------------------| |-------------------------------------| |-------------------------------------| |-------------------------------------| |-------------------------------------| */
   &trans                                     &trans                                  &trans                                  &trans                                  &trans                                  &trans                                                                        &kp C_PLAY_PAUSE                        &kp C_VOL_UP                            &trans                                  &trans                                  &trans                                   &trans                                  &trans                                     &trans

/* ── Row 3 ─────────────────────────────────────────────── */
/* │                 ---                 │ │                 ---                 │ │                 ---                 │ │                 ---                 │ │                 ---                 │ │                 ---                 │                                        │                 ---                 │ │                 ---                 │ │                 ---                 │ │                 ---                 │ │                 ---                 │ │                 ---                 │ */
/* |-------------------------------------| |-------------------------------------| |-------------------------------------| |-------------------------------------| |-------------------------------------| |-------------------------------------|                                        |-------------------------------------| |-------------------------------------| |-------------------------------------| |-------------------------------------| |-------------------------------------| |-------------------------------------| */
   &trans                                     &trans                                  &trans                                  &trans                                  &trans                                  &trans                                                                         &trans                                   &trans                                  &trans                                   &trans                                  &trans                                     &trans

/* ── Row 4 ─────────────────────────────────────────────── */
/* │                MAGIC                │ │                 ---                 │ │                 ---                 │ │                 ---                 │ │                 ---                 │ │                 ---                 │ │               C_NEXT                │ │              C_VOL_DN               │ │                 ---                 │ │                 ---                 │ │                 ---                 │ │                 ---                 │ │                 ---                 │ │                 ---                 │ */
/* |-------------------------------------| |-------------------------------------| |-------------------------------------| |-------------------------------------| |-------------------------------------| |-------------------------------------| |-------------------------------------| |-------------------------------------| |-------------------------------------| |-------------------------------------| |-------------------------------------| |-------------------------------------| |-------------------------------------| |-------------------------------------| */
   &none                                             &trans                                  &trans                                  &trans                                  &trans                                  &trans                                                                        &kp C_NEXT                              &kp C_VOL_DN                            &trans                                   &trans                                  &trans                                   &trans                                  &trans                                     &trans

/* ── Row 5 ─────────────────────────────────────────────── */
/* │                LCTRL                │ │                 ---                 │ │                 ---                 │ │                 ---                 │ │                RCLK                 │                                        │                LEFT                 │ │                 ---                 │ │                 ---                 │ │                 ---                 │ │                HYPER                │ */
/* |-------------------------------------| |-------------------------------------| |-------------------------------------| |-------------------------------------| |-------------------------------------|                                        |-------------------------------------| |-------------------------------------| |-------------------------------------| |-------------------------------------| |-------------------------------------| */
   &kp LCTRL                              &trans                                  &trans                                  &trans                                                                                                                                                        &mkp RCLK                                                                      &arrow_left LC(LEFT) LEFT               &trans                                  &trans                                    &trans                                  &hyper_key

/* ── Extra thumbs T4-T5 (slicemk-only) ─────────────────── */
/* │                 DEL                 │ │                 ---                 │                                        │               C_NEXT                │ │                 DEL                 │ */
/* |-------------------------------------| |-------------------------------------|                                        |-------------------------------------| |-------------------------------------| */
   &kp DEL                                &trans                                                                         &kp C_NEXT                              &kp DEL

/* ── Primary thumbs T1-T3 ──────────────────────────────── */
/* │                 ---                 │ │                 ---                 │ │                 ---                 │                                        │                 ---                 │ │                 ---                 │ │                 ---                 │ */
/* |-------------------------------------| |-------------------------------------| |-------------------------------------|                                        |-------------------------------------| |-------------------------------------| |-------------------------------------| */
   &trans                                  &trans                                  &trans                                                                         &trans                                    &trans                                  &trans

/* ── Extra thumb T6 (slicemk-only) ─────────────────────── */
/* │           Keypad/QUESTION           │                                        │            Symbol/PERIOD            │ */
/* |-------------------------------------|                                        |-------------------------------------| */
   &lt LAYER_Keypad QUESTION                                                     &lt LAYER_Symbol PERIOD

            >;
        };
