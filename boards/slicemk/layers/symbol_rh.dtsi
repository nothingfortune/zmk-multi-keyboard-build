/* slicemk — LAYER_Symbol_rh (row-interleaved; shared positions synced from boards/go60/layers/symbol_rh.dtsi; bindings preserved) */

        LAYER_Symbol_rh {
            bindings = <

/* ── Special top key (slicemk-only) ────────────────────── */
/* │                 ---                 │ */
/* |-------------------------------------| */
   &none

/* ── Row 1 ─────────────────────────────────────────────── */
/* │                 ---                 │ │                 ---                 │ │                 ---                 │ │                 ---                 │ │                 ---                 │ │                 ---                 │ │                 ---                 │ │                 ---                 │ │                 ---                 │ │                 ---                 │ │                 ---                 │ │                 ---                 │ │                 ---                 │ │                 ---                 │ */
/* |-------------------------------------| |-------------------------------------| |-------------------------------------| |-------------------------------------| |-------------------------------------| |-------------------------------------| |-------------------------------------| |-------------------------------------| |-------------------------------------| |-------------------------------------| |-------------------------------------| |-------------------------------------| |-------------------------------------| |-------------------------------------| */
   &trans                                   &trans                                  &trans                                  &trans                                  &trans                                    &trans                                                                       &trans                                  &trans                                  &trans                                  &trans                                  &trans                                  &trans                                  &trans                                  &trans

/* ── Row 2 ─────────────────────────────────────────────── */
/* │                 ---                 │ │                  ~                  │ │                  $                  │ │                  #                  │ │                  ^                  │ │                 ---                 │ │            C_PLAY_PAUSE             │ │              C_VOL_UP               │ │                 ---                 │ │                 ---                 │ │                 ---                 │ │                 ---                 │ │                 ---                 │ │                 ---                 │ */
/* |-------------------------------------| |-------------------------------------| |-------------------------------------| |-------------------------------------| |-------------------------------------| |-------------------------------------| |-------------------------------------| |-------------------------------------| |-------------------------------------| |-------------------------------------| |-------------------------------------| |-------------------------------------| |-------------------------------------| |-------------------------------------| */
   &trans                                  &kp TILDE                               &kp DOLLAR                                &kp HASH                                &kp CARET                                 &trans                                                                       &kp C_PLAY_PAUSE                        &kp C_VOL_UP                            &trans                                  &trans                                  &trans                                  &trans                                  &trans                                  &trans

/* ── Row 3 ─────────────────────────────────────────────── */
/* │              CAPS WORD              │ │                  -                  │ │                  *                  │ │                  |                  │ │                  &                  │ │                 ---                 │                                        │                 ---                 │ │                 ---                 │ │                 ---                 │ │                 ---                 │ │                 ---                 │ │                 ---                 │ */
/* |-------------------------------------| |-------------------------------------| |-------------------------------------| |-------------------------------------| |-------------------------------------| |-------------------------------------|                                        |-------------------------------------| |-------------------------------------| |-------------------------------------| |-------------------------------------| |-------------------------------------| |-------------------------------------| */
   &caps_word                              &kp MINUS                               &kp STAR                                &kp PIPE                                  &kp AMPS                                  &trans                                                                         &kp H                                   &trans                                  &trans                                  &trans                                  &trans                                  &trans

/* ── Row 4 ─────────────────────────────────────────────── */
/* │                MAGIC                │ │                  {                  │ │                  }                  │ │                 <>                  │ │                  >                  │ │                 ---                 │ │               C_NEXT                │ │              C_VOL_DN               │ │                 ---                 │ │                 ---                 │ │                 ---                 │ │                 ---                 │ │                 ---                 │ │                 ---                 │ */
/* |-------------------------------------| |-------------------------------------| |-------------------------------------| |-------------------------------------| |-------------------------------------| |-------------------------------------| |-------------------------------------| |-------------------------------------| |-------------------------------------| |-------------------------------------| |-------------------------------------| |-------------------------------------| |-------------------------------------| |-------------------------------------| */
   &none                                          &pair_brace                              &kp RBRC                                &pair_angle                               &kp GT                                    &trans                                                                       &kp C_NEXT                              &kp C_VOL_DN                            &trans                                  &trans                                  &trans                                  &trans                                  &trans                                  &trans

/* ── Row 5 ─────────────────────────────────────────────── */
/* │                LCTRL                │ │                 ---                 │ │                 ---                 │ │                 ---                 │ │                RCLK                 │                                        │                LEFT                 │ │                 ---                 │ │                 ---                 │ │                 ---                 │ │                HYPER                │ */
/* |-------------------------------------| |-------------------------------------| |-------------------------------------| |-------------------------------------| |-------------------------------------|                                        |-------------------------------------| |-------------------------------------| |-------------------------------------| |-------------------------------------| |-------------------------------------| */
   &kp LCTRL                              &trans                                  &trans                                   &trans                                                                                                                                                                                                &mkp RCLK                                                                      &arrow_left LC(LEFT) LEFT               &trans                                  &trans                                  &trans                                  &hyper_key

/* ── Extra thumbs T4-T5 (slicemk-only) ─────────────────── */
/* │                 DEL                 │ │                 ---                 │                                        │               C_NEXT                │ │                 DEL                 │ */
/* |-------------------------------------| |-------------------------------------|                                        |-------------------------------------| |-------------------------------------| */
   &kp DEL                                &trans                                                                         &kp C_NEXT                              &kp DEL

/* ── Primary thumbs T1-T3 ──────────────────────────────── */
/* │               TO BASE               │ │                 ---                 │ │                 ---                 │                                        │                 ---                 │ │                 ---                 │ │                 ---                 │ */
/* |-------------------------------------| |-------------------------------------| |-------------------------------------|                                        |-------------------------------------| |-------------------------------------| |-------------------------------------| */
   &to LAYER_Base                               &trans                                   &trans                                                                         &trans                                  &trans                                  &trans

/* ── Extra thumb T6 (slicemk-only) ─────────────────────── */
/* │           Keypad/QUESTION           │                                        │            Symbol/PERIOD            │ */
/* |-------------------------------------|                                        |-------------------------------------| */
   &lt LAYER_Keypad QUESTION                                                     &lt LAYER_Symbol PERIOD

            >;
        };
