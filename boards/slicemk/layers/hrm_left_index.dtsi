/* slicemk — LAYER_LeftIndex (row-interleaved; shared positions synced from boards/go60/layers/hrm_left_index.dtsi; bindings preserved) */

        LAYER_LeftIndex {
            bindings = <

/* ── Special top key (slicemk-only) ────────────────────── */
/* │                 ---                 │ */
/* |-------------------------------------| */
   &none

/* ── Row 1 ─────────────────────────────────────────────── */
/* │                 Esc                 │ │                  1                  │ │                  2                  │ │                  3                  │ │                  4                  │ │                  5                  │ │                 ---                 │ │                 ---                 │ │                  6                  │ │                  7                  │ │                  8                  │ │                  9                  │ │                  0                  │ │                 {}                  │ */
/* |-------------------------------------| |-------------------------------------| |-------------------------------------| |-------------------------------------| |-------------------------------------| |-------------------------------------| |-------------------------------------| |-------------------------------------| |-------------------------------------| |-------------------------------------| |-------------------------------------| |-------------------------------------| |-------------------------------------| |-------------------------------------| */
   &HRM_left_index_tap_v1B_TKZ EQUAL                     &trans                                  &trans                                  &trans                                    &trans                                  &trans                                                                        &trans                                  &trans                                  &trans                                   &trans                                  &trans                                  &trans                                  &trans                                   &trans

/* ── Row 2 ─────────────────────────────────────────────── */
/* │                 ---                 │ │                  Q                  │ │                  W                  │ │                  E                  │ │                  R                  │ │                  T                  │ │            C_PLAY_PAUSE             │ │              C_VOL_UP               │ │                  Y                  │ │                  U                  │ │                  I                  │ │                  O                  │ │                  P                  │ │                 \|                  │ */
/* |-------------------------------------| |-------------------------------------| |-------------------------------------| |-------------------------------------| |-------------------------------------| |-------------------------------------| |-------------------------------------| |-------------------------------------| |-------------------------------------| |-------------------------------------| |-------------------------------------| |-------------------------------------| |-------------------------------------| |-------------------------------------| */
   &trans                                 &HRM_left_index_tap_v1B_TKZ Q            &HRM_left_index_tap_v1B_TKZ W            &HRM_left_index_tap_v1B_TKZ E           &HRM_left_index_tap_v1B_TKZ R           &HRM_left_index_tap_v1B_TKZ T                                                           &kp C_PLAY_PAUSE                        &kp C_VOL_UP                            &trans                                   &trans                                  &trans                                  &trans                                  &trans                                   &trans

/* ── Row 3 ─────────────────────────────────────────────── */
/* │                CAPS                 │ │                  A                  │ │                  S                  │ │                  D                  │ │                  F                  │ │                  G                  │                                        │                  H                  │ │                  J                  │ │                  K                  │ │                  L                  │ │                SEMI                 │ │                QUOTE                │ */
/* |-------------------------------------| |-------------------------------------| |-------------------------------------| |-------------------------------------| |-------------------------------------| |-------------------------------------|                                        |-------------------------------------| |-------------------------------------| |-------------------------------------| |-------------------------------------| |-------------------------------------| |-------------------------------------| */
   &trans                                 &HRM_left_index_pinky_v1B_TKZ LGUI A    &HRM_left_index_ring_v1B_TKZ LALT S      &HRM_left_index_middy_v1B_TKZ LCTRL D                 &none                                   &HRM_left_index_tap_v1B_TKZ G                                                           &trans                                   &kp J                                   &kp K                                    &kp L                                   &kp SEMI                                 &trans

/* ── Row 4 ─────────────────────────────────────────────── */
/* │                MAGIC                │ │                  Z                  │ │                  X                  │ │                  C                  │ │                  V                  │ │                  B                  │ │               C_NEXT                │ │              C_VOL_DN               │ │                  N                  │ │                  M                  │ │                COMMA                │ │                 DOT                 │ │                QMARK                │ │                LSHFT                │ */
/* |-------------------------------------| |-------------------------------------| |-------------------------------------| |-------------------------------------| |-------------------------------------| |-------------------------------------| |-------------------------------------| |-------------------------------------| |-------------------------------------| |-------------------------------------| |-------------------------------------| |-------------------------------------| |-------------------------------------| |-------------------------------------| */
   &trans                                 &HRM_left_index_tap_v1B_TKZ Z           &HRM_left_index_tap_v1B_TKZ X            &HRM_left_index_tap_v1B_TKZ C           &HRM_left_index_tap_v1B_TKZ V            &HRM_left_index_tap_v1B_TKZ B                                                           &kp C_NEXT                              &kp C_VOL_DN                            &trans                                  &trans                                  &trans                                  &trans                                  &trans                                   &trans

/* ── Row 5 ─────────────────────────────────────────────── */
/* │                LCTRL                │ │                LCTRL                │ │                 ---                 │ │                 ---                 │ │                RCLK                 │                                        │                LEFT                 │ │                 ---                 │ │                 ---                 │ │                 ---                 │ │                HYPER                │ */
/* |-------------------------------------| |-------------------------------------| |-------------------------------------| |-------------------------------------| |-------------------------------------|                                        |-------------------------------------| |-------------------------------------| |-------------------------------------| |-------------------------------------| |-------------------------------------| */
   &kp LCTRL                              &trans                                  &trans                                  &trans                                                                                                                                                       &mkp RCLK                                                                      &arrow_left LC(LEFT) LEFT               &trans                                  &trans                                   &trans                                  &hyper_key

/* ── Extra thumbs T4-T5 (slicemk-only) ─────────────────── */
/* │                 DEL                 │ │                 ---                 │                                        │               C_NEXT                │ │                 DEL                 │ */
/* |-------------------------------------| |-------------------------------------|                                        |-------------------------------------| |-------------------------------------| */
   &kp DEL                                &trans                                                                         &kp C_NEXT                              &kp DEL

/* ── Primary thumbs T1-T3 ──────────────────────────────── */
/* │                 ---                 │ │                 ---                 │ │                 ---                 │                                        │                 ---                 │ │                 ---                 │ │                 ---                 │ */
/* |-------------------------------------| |-------------------------------------| |-------------------------------------|                                        |-------------------------------------| |-------------------------------------| |-------------------------------------| */
   &trans                                    &trans                                  &trans                                                                         &trans                                    &trans                                  &trans

/* ── Extra thumb T6 (slicemk-only) ─────────────────────── */
/* │           Keypad/QUESTION           │                                        │            Symbol/PERIOD            │ */
/* |-------------------------------------|                                        |-------------------------------------| */
   &lt LAYER_Keypad QUESTION                                                     &lt LAYER_Symbol PERIOD

            >;
        };
