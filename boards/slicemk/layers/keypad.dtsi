/* slicemk — LAYER_Keypad (row-interleaved; shared positions synced from boards/go60/layers/keypad.dtsi; bindings preserved) */

        LAYER_Keypad {
            bindings = <

/* ── Special top key (slicemk-only) ──────────────────────────────────────────────────────────────────────────────────────────────────────────────────────────────────────────────────────────────────────────────────────────────────────────────────────────────────────────────────── */
/* │                 ---                 │ */
/* |-------------------------------------| */
    &none

/* ── Row 1 ───────────────────────────────────────────────────────────────────────────────────────────────────────────────────────────────────────────────────────────────────────────────────────────────────────────────────────────────────────────────────────────────────────────── */
/* │                 F1                  │ │                 F2                  │ │                 F3                  │ │                 F4                  │ │                 F5                  │ │                 F6                  │ │                 ---                 │ │                 ---                 │ │                 F7                  │ │                 F8                  │ │                 F9                  │ │                 F10                 │ │                 F11                 │ │                 F12                 │ */
/* |-------------------------------------| |-------------------------------------| |-------------------------------------| |-------------------------------------| |-------------------------------------| |-------------------------------------| |-------------------------------------| |-------------------------------------| |-------------------------------------| |-------------------------------------| |-------------------------------------| |-------------------------------------| |-------------------------------------| |-------------------------------------| */
    &kp F1                                     &kp F2                                  &kp F3                                  &kp F4                                   &kp F5                                  &kp F6                                                                        &trans                                  &trans                                  &kp F7                                  &kp F8                                   &kp F9                                  &kp F10                                 &kp F11                                 &kp F12

/* ── Row 2 ───────────────────────────────────────────────────────────────────────────────────────────────────────────────────────────────────────────────────────────────────────────────────────────────────────────────────────────────────────────────────────────────────────────── */
/* │                 TAB                 │ │                  *                  │ │                  7                  │ │                  8                  │ │                  9                  │ │                  /                  │ │            C_PLAY_PAUSE             │ │              C_VOL_UP               │ │                  /                  │ │                  7                  │ │                  8                  │ │                  9                  │ │                STAR                 │ │                 ---                 │ */
/* |-------------------------------------| |-------------------------------------| |-------------------------------------| |-------------------------------------| |-------------------------------------| |-------------------------------------| |-------------------------------------| |-------------------------------------| |-------------------------------------| |-------------------------------------| |-------------------------------------| |-------------------------------------| |-------------------------------------| |-------------------------------------| */
    &kp TAB                                  &kp STAR                                 &kp N7                                  &kp N8                                  &kp N9                                  &kp SLASH                                                                     &kp C_PLAY_PAUSE                        &kp C_VOL_UP                            &kp SLASH                               &kp N7                                   &kp N8                                  &kp N9                                  &kp STAR                                 &trans

/* ── Row 3 ───────────────────────────────────────────────────────────────────────────────────────────────────────────────────────────────────────────────────────────────────────────────────────────────────────────────────────────────────────────────────────────────────────────── */
/* │                 ---                 │ │                  -                  │ │                  4                  │ │                  5                  │ │                  6                  │ │                  +                  │                                        │                  +                  │ │                  4                  │ │                  5                  │ │                  6                  │ │                  +                  │ │                 ---                 │ */
/* |-------------------------------------| |-------------------------------------| |-------------------------------------| |-------------------------------------| |-------------------------------------| |-------------------------------------|                                        |-------------------------------------| |-------------------------------------| |-------------------------------------| |-------------------------------------| |-------------------------------------| |-------------------------------------| */
    &none                                    &kp MINUS                               &kp N4                                   &kp N5                                  &kp N6                                  &kp PLUS                                                                       &kp PLUS                                &kp N4                                   &kp N5                                  &kp N6                                  &kp PLUS                                 &trans

/* ── Row 4 ───────────────────────────────────────────────────────────────────────────────────────────────────────────────────────────────────────────────────────────────────────────────────────────────────────────────────────────────────────────────────────────────────────────── */
/* │                MAGIC                │ │                  =                  │ │                  1                  │ │                  2                  │ │                  3                  │ │                  -                  │ │               C_NEXT                │ │              C_VOL_DN               │ │                  -                  │ │                  1                  │ │                  2                  │ │                  3                  │ │                  =                  │ │                 DEL                 │ */
/* |-------------------------------------| |-------------------------------------| |-------------------------------------| |-------------------------------------| |-------------------------------------| |-------------------------------------| |-------------------------------------| |-------------------------------------| |-------------------------------------| |-------------------------------------| |-------------------------------------| |-------------------------------------| |-------------------------------------| |-------------------------------------| */
    &none                                            &kp EQUAL                                 &kp N1                                  &kp N2                                  &kp N3                                  &kp MINUS                                                                     &kp C_NEXT                              &kp C_VOL_DN                            &kp MINUS                               &kp N1                                   &kp N2                                  &kp N3                                  &kp ENTER                               &kp DEL

/* ── Row 5 ───────────────────────────────────────────────────────────────────────────────────────────────────────────────────────────────────────────────────────────────────────────────────────────────────────────────────────────────────────────────────────────────────────────── */
/* │                LCTRL                │ │                ENTER                │ │                  .                  │ │                  0                  │ │                RCLK                 │                                        │                LEFT                 │ │                 N0                  │ │                  .                  │ │               RETURN                │ │                HYPER                │ */
/* |-------------------------------------| |-------------------------------------| |-------------------------------------| |-------------------------------------| |-------------------------------------|                                        |-------------------------------------| |-------------------------------------| |-------------------------------------| |-------------------------------------| |-------------------------------------| */
    &kp LCTRL                               &kp RET                                  &kp DOT                                  &kp N0                                                                                                                                                      &mkp RCLK                                                                      &arrow_left LC(LEFT) LEFT               &kp N0                                  &kp DOT                                 &kp RET                                 &hyper_key

/* ── Extra thumbs T4-T5 (slicemk-only) ───────────────────────────────────────────────────────────────────────────────────────────────────────────────────────────────────────────────────────────────────────────────────────────────────────────────────────────────────────────────── */
/* │                 DEL                 │ │                 ---                 │                                        │               C_NEXT                │ │                 DEL                 │ */
/* |-------------------------------------| |-------------------------------------|                                        |-------------------------------------| |-------------------------------------| */
    &kp DEL                                 &trans                                                                         &kp C_NEXT                              &kp DEL

/* ── Primary thumbs T1-T3 ────────────────────────────────────────────────────────────────────────────────────────────────────────────────────────────────────────────────────────────────────────────────────────────────────────────────────────────────────────────────────────────── */
/* │           NAV(hold)/SPACE           │ │                 ---                 │ │                 ---                 │                                        │                 ---                 │ │                 ---                 │ │                 ---                 │ */
/* |-------------------------------------| |-------------------------------------| |-------------------------------------|                                        |-------------------------------------| |-------------------------------------| |-------------------------------------| */
    &mo LAYER_Symbol                             &trans                                   &trans                                                                         &trans                                  &trans                                  &trans

/* ── Extra thumb T6 (slicemk-only) ───────────────────────────────────────────────────────────────────────────────────────────────────────────────────────────────────────────────────────────────────────────────────────────────────────────────────────────────────────────────────── */
/* │           Keypad/QUESTION           │                                        │            Symbol/PERIOD            │ */
/* |-------------------------------------|                                        |-------------------------------------| */
    &lt LAYER_Keypad QUESTION                                                      &lt LAYER_Symbol PERIOD

            >;
        };
