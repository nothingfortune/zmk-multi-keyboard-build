/* glove80 — LAYER_Base (row-interleaved; shared positions synced from boards/go60/layers/base.dtsi) */

        LAYER_Base {
            bindings = <

/* Row 0 — function row */
/*                                                  ESC/`                                           F1                                              F2                                              F3                                              F4                                                                                                                                                                                                                                                                                                                                              F6                                              F7                                              F8                                              F9                                              F10 */
                                                    &gresc                                          &kp F1                                          &kp F2                                          &kp F3                                          &kp F4                                                                                                                                                                                                                                                                                                                                          &kp F6                                          &kp F7                                          &kp F8                                          &kp F9                                          &kp F10

/* Row 1 — number row */
/*  ESC/`                                           1/!                                             2/@                                             3/#                                             4/$                                             5/%                                                                                                                                                                                                                                                                                                                                             6/^                                             7/&                                             8/*                                             9/()                                            0/)                                             {} */
    &gresc                                          &num_ht LS(N1) N1                               &num_ht LS(N2) N2                               &num_ht LS(N3) N3                               &num_ht LS(N4) N4                               &num_ht LS(N5) N5                                                                                                                                                                                                                                                                                                                               &num_ht LS(N6) N6                               &num_ht LS(N7) N7                               &num_ht LS(N8) N8                               &n9_paren                                       &num_ht LS(N0) N0                               &pair_brace

/* Row 2 — top alpha row */
/*  TAB                                             Q                                               W                                               E                                               R                                               T                                                                                                                                                                                                                                                                                                                                               Y                                               U                                               I                                               O                                               P                                               () */
    &tab_hyper LS(LC(LA(LGUI))) TAB                 &kp Q                                           &kp W                                           &kp E                                           &kp R                                           &kp T                                                                                                                                                                                                                                                                                                                                           &kp Y                                           &kp U                                           &kp I                                           &kp O                                           &kp P                                           &pair_paren

/* Row 3 — home row */
/*  CAPS WORD                                       GUI(hold)/A                                     ALT(hold)/S                                     CTRL(hold)/D                                    SHIFT(hold)/F                                   SYMB(hold)/G                                                                                                                                                                                                                                                                                                                                    SYMB(hold)/H                                    SHIFT(hold)/J                                   CTRL(hold)/K                                    ALT(hold)/L                                     GUI(hold)/;                                     "" */
    &lshft_cw_td                                    &HRM_left_pinky_v1B_TKZ LGUI A                  &HRM_left_ring_v1B_TKZ LALT S                   &HRM_left_middy_v1B_TKZ LCTRL D                 &HRM_left_index_v1B_TKZ LSHFT F                 &HRMO_left_index_v1B_TKZ LAYER_Symbol_lh G                                                                                                                                                                                                                                                                                                      &HRMO_right_index_v1B_TKZ LAYER_Symbol_rh H     &HRM_right_index_v1B_TKZ RSHFT J                &HRM_right_middy_v1B_TKZ RCTRL K                &HRM_right_ring_v1B_TKZ LALT L                  &HRM_right_pinky_v1B_TKZ RGUI SEMI              &dqt_pair

/* Row 4 — bottom row + inner columns */
/*  MAGIC                                           Z                                               X                                               C                                               V                                               B                                               ---                                             ---                                             ---                                             ---                                             ---                                             ---                                             N                                               M                                               ,/<>                                            .                                               /                                               ENTER */
    &magic LAYER_Magic 0                            &kp Z                                           &kp X                                           &kp C                                           &HRMO_left_index_v1B_TKZ LAYER_Keypad V         &kp B                                           &trans                                          &trans                                          &trans                                          &trans                                          &trans                                          &trans                                          &kp N                                           &HRMO_left_index_v1B_TKZ LAYER_Keypad M         &comma_angle                                    &kp DOT                                         &kp FSLH                                        &kp RET

/* Row 5 — bottom mods + thumb cluster */
/*                                                  ---                                             LCTRL                                           LALT                                            CMD                                             ---                                             NAV(hold)/SPACE                                 ENTER                                           DEL(hold)/?                                     DEL(hold)/.                                     BSPC/DEL-WORD                                   NAV(hold)/SPACE                                 ---                                             LEFT/WORD-LEFT                                  DOWN                                            RIGHT/WORD-RIGHT                                --- */
                                                    &trans                                          &kp LCTRL                                       &kp LALT                                        &kp LGUI                                        &trans                                          &thumb_v2_TKZ LAYER_Cursor SPACE                &thumb_v2_TKZ LAYER_Keypad RET                  &thumb_v2_TKZ DEL QMARK                         &thumb_v2_TKZ DEL PERIOD                        &bspc_word LA(BSPC) BSPC                        &thumb_v2_TKZ LAYER_Keypad SPACE                &trans                                          &arrow_left LA(LEFT) LEFT                       &upDownArrows                                   &arrow_right LA(RIGHT) RIGHT                    &trans

            >;
        };
