/* glove80 — LAYER_RightPinky (row-interleaved; shared positions synced from boards/go60/layers/hrm_right_pinky.dtsi) */

        LAYER_RightPinky {
            bindings = <

/* ── Row 0 — function row (glove80-only) ─────────────────────────────────────────────────────────────────────────────────────────────────────────────────────────────────────────────────────────────────────────────────────────────────────────────────────────────────────────────────────────── */
/* │                  ---                  │ │                  ---                  │ │                  ---                  │ │                  ---                  │ │                  ---                  │                                        │                  ---                  │ │                  ---                  │ │                  ---                  │ │                  ---                  │ │                  ---                  │ */
    &trans                                    &trans                                    &trans                                    &trans                                    &trans                                                                           &trans                                    &trans                                    &trans                                    &trans                                    &trans
/* |---------------------------------------| |---------------------------------------| |---------------------------------------| |---------------------------------------| |---------------------------------------|                                        |---------------------------------------| |---------------------------------------| |---------------------------------------| |---------------------------------------| |---------------------------------------| */

/* ── Row 1 ───────────────────────────────────────────────────────────────────────────────────────────────────────────────────────────────────────────────────────────────────────────────────────────────────────────────────────────────────────────────────────────────────────────────────────── */
/* │                  Esc                  │ │                   1                   │ │                   2                   │ │                   3                   │ │                   4                   │ │                   5                   │                                        │                   6                   │ │                   7                   │ │                   8                   │ │                   9                   │ │                   0                   │ │                  {}                   │ */
    &trans                                     &trans                                    &trans                                    &trans                                    &trans                                    &trans                                                                           &trans                                    &trans                                    &trans                                    &trans                                    &trans                                    &trans
/* |---------------------------------------| |---------------------------------------| |---------------------------------------| |---------------------------------------| |---------------------------------------| |---------------------------------------|                                        |---------------------------------------| |---------------------------------------| |---------------------------------------| |---------------------------------------| |---------------------------------------| |---------------------------------------| */

/* ── Row 2 ───────────────────────────────────────────────────────────────────────────────────────────────────────────────────────────────────────────────────────────────────────────────────────────────────────────────────────────────────────────────────────────────────────────────────────── */
/* │                  ---                  │ │                   Q                   │ │                   W                   │ │                   E                   │ │                   R                   │ │                   T                   │                                        │                   Y                   │ │                   U                   │ │                   I                   │ │                   O                   │ │                   P                   │ │                  \|                   │ */
    &trans                                     &trans                                    &trans                                    &trans                                    &trans                                    &trans                                                                           &HRM_right_pinky_tap_v1B_TKZ Y            &HRM_right_pinky_tap_v1B_TKZ U            &HRM_right_pinky_tap_v1B_TKZ I            &HRM_right_pinky_tap_v1B_TKZ O            &HRM_right_pinky_tap_v1B_TKZ P                       &trans
/* |---------------------------------------| |---------------------------------------| |---------------------------------------| |---------------------------------------| |---------------------------------------| |---------------------------------------|                                        |---------------------------------------| |---------------------------------------| |---------------------------------------| |---------------------------------------| |---------------------------------------| |---------------------------------------| */

/* ── Row 3 ───────────────────────────────────────────────────────────────────────────────────────────────────────────────────────────────────────────────────────────────────────────────────────────────────────────────────────────────────────────────────────────────────────────────────────── */
/* │                 CAPS                  │ │                   A                   │ │                   S                   │ │                   D                   │ │                   F                   │ │                   G                   │                                        │                   H                   │ │                   J                   │ │                   K                   │ │                   L                   │ │                 SEMI                  │ │                 QUOTE                 │ */
    &trans                                     &kp A                                     &kp S                                     &kp D                                     &kp F                                     &trans                                                                           &HRM_right_pinky_tap_v1B_TKZ H            &HRM_right_pinky_index_v1B_TKZ RSHFT J    &HRM_right_pinky_middy_v1B_TKZ RCTRL K    &HRM_right_pinky_ring_v1B_TKZ LALT L                  &none                                     &trans
/* |---------------------------------------| |---------------------------------------| |---------------------------------------| |---------------------------------------| |---------------------------------------| |---------------------------------------|                                        |---------------------------------------| |---------------------------------------| |---------------------------------------| |---------------------------------------| |---------------------------------------| |---------------------------------------| */

/* ── Row 4 — bottom row + inner columns (52-57 glove80-only) ─────────────────────────────────────────────────────────────────────────────────────────────────────────────────────────────────────────────────────────────────────────────────────────────────────────────────────────────────────── */
/* │                 MAGIC                 │ │                   Z                   │ │                   X                   │ │                   C                   │ │                   V                   │ │                   B                   │ │                  ---                  │ │                  ---                  │ │                  ---                  │ │                  ---                  │ │                  ---                  │ │                  ---                  │ │                   N                   │ │                   M                   │ │                 COMMA                 │ │                  DOT                  │ │                 QMARK                 │ │                 LSHFT                 │ */
    &trans                                     &trans                                    &trans                                    &trans                                    &trans                                    &trans                                                            &trans                                    &trans                                    &trans                                    &trans                                    &trans                                    &trans                                    &HRM_right_pinky_tap_v1B_TKZ N            &HRM_right_pinky_tap_v1B_TKZ M            &HRM_right_pinky_tap_v1B_TKZ COMMA        &HRM_right_pinky_tap_v1B_TKZ DOT          &HRM_right_pinky_tap_v1B_TKZ QMARK                     &trans
/* |---------------------------------------| |---------------------------------------| |---------------------------------------| |---------------------------------------| |---------------------------------------| |---------------------------------------| |---------------------------------------| |---------------------------------------| |---------------------------------------| |---------------------------------------| |---------------------------------------| |---------------------------------------| |---------------------------------------| |---------------------------------------| |---------------------------------------| |---------------------------------------| |---------------------------------------| |---------------------------------------| */

/* ── Row 5 + thumb cluster (corners 64/68/75/79 glove80-only) ────────────────────────────────────────────────────────────────────────────────────────────────────────────────────────────────────────────────────────────────────────────────────────────────────────────────────────────────────── */
/* │                  ---                  │ │                  ---                  │ │                  ---                  │ │                  ---                  │ │                  ---                  │ │                  ---                  │ │                  ---                  │ │                  ---                  │ │                  ---                  │ │                  ---                  │ │                  ---                  │ │                  ---                  │ │                  ---                  │ │                  ---                  │ │                  ---                  │ │                  ---                  │ */
    &trans                                    &trans                                    &trans                                    &trans                                                                                                                                                           &trans                                    &trans                                    &trans                                    &trans                                                                       &trans                                    &trans                                    &trans                                    &trans                                    &trans                                    &trans                                    &trans                                    &trans
/* |---------------------------------------| |---------------------------------------| |---------------------------------------| |---------------------------------------| |---------------------------------------| |---------------------------------------| |---------------------------------------| |---------------------------------------| |---------------------------------------| |---------------------------------------| |---------------------------------------| |---------------------------------------| |---------------------------------------| |---------------------------------------| |---------------------------------------| |---------------------------------------| */

            >;
        };
