/* glove80 — LAYER_Mouse (row-interleaved; shared positions synced from boards/go60/layers/mouse.dtsi) */

        LAYER_Mouse {
            bindings = <

/* ── Row 0 — function row (glove80-only) ───────────────── */
/* │                 ---                 │ │                 ---                 │ │                 ---                 │ │                 ---                 │ │                 ---                 │                                        │                 ---                 │ │                 ---                 │ │                 ---                 │ │                 ---                 │ │                 ---                 │ */
/* |-------------------------------------| |-------------------------------------| |-------------------------------------| |-------------------------------------| |-------------------------------------|                                        |-------------------------------------| |-------------------------------------| |-------------------------------------| |-------------------------------------| |-------------------------------------| */
   &trans                                 &trans                                  &trans                                  &trans                                  &trans                                                                         &trans                                  &trans                                  &trans                                  &trans                                  &trans

/* ── Row 1 ─────────────────────────────────────────────── */
/* │                 ESC                 │ │           Mission Control           │ │              SCROLL UP              │ │                 ---                 │ │             RIGHT CLOCK             │ │              ZOOM OUT               │                                        │                 ---                 │ │                 ---                 │ │                 ---                 │ │                 ---                 │ │           Mission Control           │ │             App Exposè              │ */
/* |-------------------------------------| |-------------------------------------| |-------------------------------------| |-------------------------------------| |-------------------------------------| |-------------------------------------|                                        |-------------------------------------| |-------------------------------------| |-------------------------------------| |-------------------------------------| |-------------------------------------| |-------------------------------------| */
   &kp ESC                                &mac_mission_ctl                           &msc SCRL_UP                               &trans                                  &mkp RCLK                               &kp LG(MINUS)                                                                  &trans                                   &trans                                  &trans                                    &trans                                  &mac_mission_ctl                         &mac_app_expose

/* ── Row 2 ─────────────────────────────────────────────── */
/* │               Expose                │ │                 ---                 │ │             SCROLL DOWN             │ │              MOUSE UP               │ │             LEFT CLICK              │ │               ZOOM IN               │                                        │                 ---                 │ │                 ---                 │ │               MOVE UP               │ │                 ---                 │ │                 ---                 │ │                 ---                 │ */
/* |-------------------------------------| |-------------------------------------| |-------------------------------------| |-------------------------------------| |-------------------------------------| |-------------------------------------|                                        |-------------------------------------| |-------------------------------------| |-------------------------------------| |-------------------------------------| |-------------------------------------| |-------------------------------------| */
   &mac_app_expose                                 &trans                                  &msc SCRL_DOWN                           &mmv MOVE_UP                             &mkp LCLK                               &kp LG(PLUS)                                                                   &trans                                   &trans                                  &mmv MOVE_UP                                &trans                                  &trans                                     &trans

/* ── Row 3 ─────────────────────────────────────────────── */
/* │                 ---                 │ │             SCROLL LEFT             │ │             MOUSE LEFT              │ │             MOUSE DOWN              │ │             MOUNT RIGHT             │ │            SCROLL RIGHT             │                                        │                 ---                 │ │              MOVE LEFT              │ │              MOVE DOWN              │ │             MOVE RIGHT              │ │                 ---                 │ │                 ---                 │ */
/* |-------------------------------------| |-------------------------------------| |-------------------------------------| |-------------------------------------| |-------------------------------------| |-------------------------------------|                                        |-------------------------------------| |-------------------------------------| |-------------------------------------| |-------------------------------------| |-------------------------------------| |-------------------------------------| */
   &trans                                 &msc SCRL_LEFT                          &mmv MOVE_LEFT                           &mmv MOVE_DOWN                          &mmv MOVE_RIGHT                          &msc SCRL_RIGHT                                                                 &trans                                  &mmv MOVE_LEFT                          &mmv MOVE_DOWN                            &mmv MOVE_RIGHT                             &trans                                     &trans

/* ── Row 4 — bottom row + inner columns (52-57 glove80-only)  */
/* │                 ---                 │ │             SCROLL DOWN             │ │              MOUSESLOW              │ │              MOUSEFAST              │ │              MOUSEWARP              │ │                 DEL                 │ │                 ---                 │ │                 ---                 │ │                 ---                 │ │                 ---                 │ │                 ---                 │ │                 ---                 │ │                 ---                 │ │              MOUSEWARP              │ │              MOUSEFAST              │ │              MOUSESLOW              │ │                 ---                 │ │                 ---                 │ */
/* |-------------------------------------| |-------------------------------------| |-------------------------------------| |-------------------------------------| |-------------------------------------| |-------------------------------------| |-------------------------------------| |-------------------------------------| |-------------------------------------| |-------------------------------------| |-------------------------------------| |-------------------------------------| |-------------------------------------| |-------------------------------------| |-------------------------------------| |-------------------------------------| |-------------------------------------| |-------------------------------------| */
   &none                                  &msc SCRL_DOWN                          &mo LAYER_MouseSlow                      &mo LAYER_MouseFast                     &mo LAYER_MouseWarp                           &kp DEL                                                                      &trans                                  &trans                                  &trans                                  &trans                                  &trans                                  &trans                                  &trans                                  &mo LAYER_MouseWarp                     &mo LAYER_MouseFast                     &mo LAYER_MouseSlow                            &trans                                     &trans

/* ── Row 5 + thumb cluster (corners 64/68/75/79 glove80-only)  */
/* │                 ---                 │ │                 ---                 │ │                 ---                 │ │                 ---                 │ │                 ---                 │ │                 DEL                 │ │                 ---                 │ │                 DEL                 │ │             LEFT MOUSE              │ │                 ---                 │ │                 ---                 │ │                 ---                 │ │                 ---                 │ │                 ---                 │ │                 ---                 │ │                 ---                 │ */
/* |-------------------------------------| |-------------------------------------| |-------------------------------------| |-------------------------------------| |-------------------------------------| |-------------------------------------| |-------------------------------------| |-------------------------------------| |-------------------------------------| |-------------------------------------| |-------------------------------------| |-------------------------------------| |-------------------------------------| |-------------------------------------| |-------------------------------------| |-------------------------------------| */
   &trans                                 &trans                                  &trans                                  &trans                                                                                                                                                                                               &trans                                  &kp DEL                                  &trans                                   &kp DEL                                                                    &mkp LCLK                                  &trans                                  &trans                                  &trans                                  &trans                                  &trans                                     &trans                                  &trans

            >;
        };
