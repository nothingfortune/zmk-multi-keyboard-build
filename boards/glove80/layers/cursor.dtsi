/* glove80 — LAYER_Cursor (row-interleaved; shared positions synced from boards/go60/layers/cursor.dtsi) */

        LAYER_Cursor {
            bindings = <

/* ── Row 0 — function row (glove80-only) ───────────────── */
/* │                 ---                 │ │                 ---                 │ │                 ---                 │ │                 ---                 │ │                 ---                 │                                        │                 ---                 │ │                 ---                 │ │                 ---                 │ │                 ---                 │ │                 ---                 │ */
/* |-------------------------------------| |-------------------------------------| |-------------------------------------| |-------------------------------------| |-------------------------------------|                                        |-------------------------------------| |-------------------------------------| |-------------------------------------| |-------------------------------------| |-------------------------------------| */
   &trans                                 &trans                                  &trans                                  &trans                                  &trans                                                                         &trans                                  &trans                                  &trans                                  &trans                                  &trans

/* ── Row 1 ─────────────────────────────────────────────── */
/* │                 ---                 │ │                 ---                 │ │                 ---                 │ │                 ---                 │ │             RIGHT CLICK             │ │              SCROLL UP              │                                        │              SCROLL UP              │ │                 ---                 │ │                 ---                 │ │                 ---                 │ │                 ---                 │ │                 ---                 │ */
/* |-------------------------------------| |-------------------------------------| |-------------------------------------| |-------------------------------------| |-------------------------------------| |-------------------------------------|                                        |-------------------------------------| |-------------------------------------| |-------------------------------------| |-------------------------------------| |-------------------------------------| |-------------------------------------| */
   &trans                                     &trans                                   &none                                   &trans                                  &mkp RCLK                                  &kp LG(PLUS)                                                                   &msc SCRL_UP                                 &trans                                  &trans                                   &trans                                  &trans                                    &trans

/* ── Row 2 ─────────────────────────────────────────────── */
/* │                 ---                 │ │                 ---                 │ │                 ---                 │ │              MOUSE UP               │ │             LEFT CLICK              │ │             SCROLL DOWN             │                                        │                 ---                 │ │                 ---                 │ │               MOVE UP               │ │                 ---                 │ │                 ---                 │ │                 ---                 │ */
/* |-------------------------------------| |-------------------------------------| |-------------------------------------| |-------------------------------------| |-------------------------------------| |-------------------------------------|                                        |-------------------------------------| |-------------------------------------| |-------------------------------------| |-------------------------------------| |-------------------------------------| |-------------------------------------| */
   &trans                                     &trans                                   &none                                   &mmv MOVE_UP                             &mkp LCLK                                &kp LG(MINUS)                                                                  &msc SCRL_DOWN                               &trans                                  &mmv MOVE_UP                               &trans                                  &trans                                    &trans

/* ── Row 3 ─────────────────────────────────────────────── */
/* │                 ---                 │ │                 ---                 │ │             MOUSE LEFT              │ │             MOUSE DOWN              │ │             MOUSE RIGHT             │ │                 ---                 │                                        │                 ---                 │ │              MOVE LEFT              │ │              MOVE DOWN              │ │             MOVE RIGHT              │ │                 ---                 │ │                 ---                 │ */
/* |-------------------------------------| |-------------------------------------| |-------------------------------------| |-------------------------------------| |-------------------------------------| |-------------------------------------|                                        |-------------------------------------| |-------------------------------------| |-------------------------------------| |-------------------------------------| |-------------------------------------| |-------------------------------------| */
   &trans                                     &none                                   &mmv MOVE_LEFT                           &mmv MOVE_DOWN                          &mmv MOVE_RIGHT                              &none                                                                          &trans                                  &mmv MOVE_LEFT                          &mmv MOVE_DOWN                          &mmv MOVE_RIGHT                             &trans                                     &trans

/* ── Row 4 — bottom row + inner columns (52-57 glove80-only)  */
/* │                 ---                 │ │                 ---                 │ │                 ---                 │ │              MOUSEFAST              │ │              MOUSEWARP              │ │              MOUSESLOW              │ │                 ---                 │ │                 ---                 │ │                 ---                 │ │                 ---                 │ │                 ---                 │ │                 ---                 │ │              MOUSESLOW              │ │              MOUSEWARP              │ │              MOUSEFAST              │ │                 ---                 │ │                 ---                 │ │                 ---                 │ */
/* |-------------------------------------| |-------------------------------------| |-------------------------------------| |-------------------------------------| |-------------------------------------| |-------------------------------------| |-------------------------------------| |-------------------------------------| |-------------------------------------| |-------------------------------------| |-------------------------------------| |-------------------------------------| |-------------------------------------| |-------------------------------------| |-------------------------------------| |-------------------------------------| |-------------------------------------| |-------------------------------------| */
   &none                                      &none                                   &none                                   &mo LAYER_MouseFast                     &mo LAYER_MouseWarp                     &mo LAYER_MouseSlow                                                         &trans                                  &trans                                  &trans                                  &trans                                  &trans                                  &trans                                  &mo LAYER_MouseSlow                     &mo LAYER_MouseWarp                     &mo LAYER_MouseFast                            &none                                   &trans                                     &trans

/* ── Row 5 + thumb cluster (corners 64/68/75/79 glove80-only)  */
/* │                 ---                 │ │                 ---                 │ │                 ---                 │ │                 ---                 │ │                 ---                 │ │                 DEL                 │ │             RIGHT CLICK             │ │             LEFT MOUSE              │ │             LEFT MOUSE              │ │             RIGHT MOUSE             │ │                 ---                 │ │                 ---                 │ │                 ---                 │ │                 ---                 │ │                 ---                 │ │                 ---                 │ */
/* |-------------------------------------| |-------------------------------------| |-------------------------------------| |-------------------------------------| |-------------------------------------| |-------------------------------------| |-------------------------------------| |-------------------------------------| |-------------------------------------| |-------------------------------------| |-------------------------------------| |-------------------------------------| |-------------------------------------| |-------------------------------------| |-------------------------------------| |-------------------------------------| */
   &trans                                 &trans                                  &trans                                  &trans                                                                                                                                                                                               &trans                                  &kp DEL                                 &mkp RCLK                                 &mkp LCLK                                                                  &mkp LCLK                                &mkp RCLK                                  &trans                                  &trans                                  &trans                                  &trans                                   &trans                                  &trans

            >;
        };
