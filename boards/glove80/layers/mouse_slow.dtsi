/* glove80 — LAYER_MouseSlow (row-interleaved; shared positions synced from boards/go60/layers/mouse_slow.dtsi) */

        LAYER_MouseSlow {
            bindings = <

/* Row 0 — function row */
/*                                                  ---                                             ---                                             ---                                             ---                                             ---                                                                                                                                                                                                                                                                                                                                             ---                                             ---                                             ---                                             ---                                             --- */
                                                    &trans                                          &trans                                          &trans                                          &trans                                          &trans                                                                                                                                                                                                                                                                                                                                          &trans                                          &trans                                          &trans                                          &trans                                          &trans

/* Row 1 — number row */
/*  ---                                             ---                                             ---                                             ---                                             ---                                             ---                                                                                                                                                                                                                                                                                                                                             ---                                             ---                                             ---                                             ---                                             ---                                             --- */
    &trans                                          &trans                                          &trans                                          &trans                                          &trans                                          &trans                                                                                                                                                                                                                                                                                                                                          &trans                                          &trans                                          &trans                                          &trans                                          &trans                                          &trans

/* Row 2 — top alpha row */
/*  ---                                             ---                                             ---                                             ---                                             ---                                             ---                                                                                                                                                                                                                                                                                                                                             ---                                             ---                                             ---                                             ---                                             ---                                             --- */
    &trans                                          &trans                                          &trans                                          &trans                                          &trans                                          &trans                                                                                                                                                                                                                                                                                                                                          &trans                                          &trans                                          &trans                                          &trans                                          &trans                                          &trans

/* Row 3 — home row */
/*  ---                                             ---                                             ---                                             ---                                             ---                                             ---                                                                                                                                                                                                                                                                                                                                             ---                                             ---                                             ---                                             ---                                             ---                                             --- */
    &trans                                          &trans                                          &trans                                          &trans                                          &trans                                          &trans                                                                                                                                                                                                                                                                                                                                          &trans                                          &trans                                          &trans                                          &trans                                          &trans                                          &trans

/* Row 4 — bottom row + inner columns */
/*  MAGIC                                           ---                                             ---                                             ---                                             ---                                             ---                                             ---                                             ---                                             ---                                             ---                                             ---                                             ---                                             ---                                             ---                                             ---                                             ---                                             ---                                             --- */
    &magic LAYER_Magic 0                            &trans                                          &trans                                          &trans                                          &trans                                          &trans                                          &trans                                          &trans                                          &trans                                          &trans                                          &trans                                          &trans                                          &trans                                          &trans                                          &trans                                          &trans                                          &trans                                          &trans

/* Row 5 — bottom mods + thumb cluster */
/*                                                  ---                                             ---                                             ---                                             ---                                             ---                                             ---                                             ---                                             ---                                             ---                                             ---                                             ---                                             ---                                             ---                                             ---                                             ---                                             --- */
                                                    &trans                                          &trans                                          &trans                                          &trans                                          &trans                                          &trans                                          &trans                                          &trans                                          &trans                                          &trans                                          &trans                                          &trans                                          &trans                                          &trans                                          &trans                                          &trans

            >;
        };
