/* glove80 — LAYER_Autoshift (row-interleaved; shared positions synced from boards/go60/layers/autoshift.dtsi) */

        LAYER_Autoshift {
            bindings = <

/* ── Row 0 — function row (glove80-only) ───────────────── */
/* │                 ---                 │ │                 ---                 │ │                 ---                 │ │                 ---                 │ │                 ---                 │                                        │                 ---                 │ │                 ---                 │ │                 ---                 │ │                 ---                 │ │                 ---                 │ */
/* |-------------------------------------| |-------------------------------------| |-------------------------------------| |-------------------------------------| |-------------------------------------|                                        |-------------------------------------| |-------------------------------------| |-------------------------------------| |-------------------------------------| |-------------------------------------| */
   &trans                                 &trans                                  &trans                                  &trans                                  &trans                                                                         &trans                                  &trans                                  &trans                                  &trans                                  &trans

/* ── Row 1 ─────────────────────────────────────────────── */
/* │                ESC/`                │ │                 ---                 │ │                 ---                 │ │                 ---                 │ │                 ---                 │ │                 ---                 │                                        │                 ---                 │ │                 ---                 │ │                 ---                 │ │                 ---                 │ │                 ---                 │ │                 ---                 │ */
/* |-------------------------------------| |-------------------------------------| |-------------------------------------| |-------------------------------------| |-------------------------------------| |-------------------------------------|                                        |-------------------------------------| |-------------------------------------| |-------------------------------------| |-------------------------------------| |-------------------------------------| |-------------------------------------| */
   &AS_v1_TKZ EQUAL                              &trans                                   &trans                                  &trans                                   &trans                                  &trans                                                                         &trans                                   &trans                                  &trans                                  &trans                                  &trans                                   &trans

/* ── Row 2 ─────────────────────────────────────────────── */
/* │                 ---                 │ │                  Q                  │ │                  W                  │ │                  E                  │ │                  R                  │ │                  T                  │                                        │                  Y                  │ │                  U                  │ │                  I                  │ │                  O                  │ │                  P                  │ │                 ---                 │ */
/* |-------------------------------------| |-------------------------------------| |-------------------------------------| |-------------------------------------| |-------------------------------------| |-------------------------------------|                                        |-------------------------------------| |-------------------------------------| |-------------------------------------| |-------------------------------------| |-------------------------------------| |-------------------------------------| */
   &trans                                  &AS_v1_TKZ Q                             &AS_v1_TKZ W                            &AS_v1_TKZ E                              &AS_v1_TKZ R                            &AS_v1_TKZ T                                                                   &AS_v1_TKZ Y                            &AS_v1_TKZ U                            &AS_v1_TKZ I                            &AS_v1_TKZ O                            &AS_v1_TKZ P                                 &trans

/* ── Row 3 ─────────────────────────────────────────────── */
/* │                 ---                 │ │                  A                  │ │                  S                  │ │                  D                  │ │                  F                  │ │                  G                  │                                        │                  H                  │ │                  J                  │ │                  K                  │ │                  L                  │ │                  ;                  │ │                 ---                 │ */
/* |-------------------------------------| |-------------------------------------| |-------------------------------------| |-------------------------------------| |-------------------------------------| |-------------------------------------|                                        |-------------------------------------| |-------------------------------------| |-------------------------------------| |-------------------------------------| |-------------------------------------| |-------------------------------------| */
   &trans                                  &AS_v1_TKZ A                             &AS_v1_TKZ S                            &AS_v1_TKZ D                              &AS_v1_TKZ F                            &AS_v1_TKZ G                                                                   &AS_v1_TKZ H                            &AS_v1_TKZ J                            &AS_v1_TKZ K                            &AS_v1_TKZ L                            &AS_v1_TKZ SEMI                               &trans

/* ── Row 4 — bottom row + inner columns (52-57 glove80-only)  */
/* │                MAGIC                │ │                  Z                  │ │                  X                  │ │                  C                  │ │                  V                  │ │                  B                  │ │                 ---                 │ │                 ---                 │ │                 ---                 │ │                 ---                 │ │                 ---                 │ │                 ---                 │ │                  N                  │ │                  M                  │ │                ,/<>                 │ │                  .                  │ │                  /                  │ │                 ---                 │ */
/* |-------------------------------------| |-------------------------------------| |-------------------------------------| |-------------------------------------| |-------------------------------------| |-------------------------------------| |-------------------------------------| |-------------------------------------| |-------------------------------------| |-------------------------------------| |-------------------------------------| |-------------------------------------| |-------------------------------------| |-------------------------------------| |-------------------------------------| |-------------------------------------| |-------------------------------------| |-------------------------------------| */
   &magic LAYER_Magic 0                           &AS_v1_TKZ Z                             &AS_v1_TKZ X                            &AS_v1_TKZ C                              &AS_v1_TKZ V                            &AS_v1_TKZ B                                                                  &trans                                  &trans                                  &trans                                  &trans                                  &trans                                  &trans                                  &AS_v1_TKZ N                            &AS_v1_TKZ M                            &AS_v1_TKZ COMMA                          &AS_v1_TKZ DOT                          &AS_v1_TKZ FSLH                               &trans

/* ── Row 5 + thumb cluster (corners 64/68/75/79 glove80-only)  */
/* │                 ---                 │ │                 ---                 │ │                 ---                 │ │                 ---                 │ │                 ---                 │ │                 ---                 │ │                 ---                 │ │                 ---                 │ │                 ---                 │ │                 ---                 │ │                 ---                 │ │                 ---                 │ │                 ---                 │ │                 ---                 │ │                 ---                 │ │                 ---                 │ */
/* |-------------------------------------| |-------------------------------------| |-------------------------------------| |-------------------------------------| |-------------------------------------| |-------------------------------------| |-------------------------------------| |-------------------------------------| |-------------------------------------| |-------------------------------------| |-------------------------------------| |-------------------------------------| |-------------------------------------| |-------------------------------------| |-------------------------------------| |-------------------------------------| */
   &trans                                 &trans                                  &trans                                  &trans                                                                                                                                                                                                    &trans                                  &trans                                     &trans                                  &trans                                                                        &trans                                  &trans                                  &trans                                  &trans                                  &trans                                  &trans                                   &trans                                  &trans

            >;
        };
