/* glove80 — LAYER_Symbol_lh (row-interleaved; shared positions synced from boards/go60/layers/symbol_lh.dtsi) */

        LAYER_Symbol_lh {
            bindings = <

/* Row 0 — function row */
/*                                                  ---                                             ---                                             ---                                             ---                                             ---                                                                                                                                                                                                                                                                                                                                             ---                                             ---                                             ---                                             ---                                             --- */
                                                    &trans                                          &trans                                          &trans                                          &trans                                          &trans                                                                                                                                                                                                                                                                                                                                          &trans                                          &trans                                          &trans                                          &trans                                          &trans

/* Row 1 — number row */
/*  ---                                             ---                                             ---                                             ---                                             ---                                             ---                                                                                                                                                                                                                                                                                                                                             ---                                             ---                                             ---                                             ---                                             ---                                             --- */
    &trans                                          &trans                                          &trans                                          &trans                                          &trans                                          &trans                                                                                                                                                                                                                                                                                                                                          &trans                                          &trans                                          &trans                                          &trans                                          &trans                                          &trans

/* Row 2 — top alpha row */
/*  ---                                             ---                                             ---                                             ---                                             ---                                             ---                                                                                                                                                                                                                                                                                                                                             ---                                             _                                               @                                               %                                               `                                               : */
    &trans                                          &trans                                          &trans                                          &trans                                          &trans                                          &trans                                                                                                                                                                                                                                                                                                                                          &trans                                          &kp UNDER                                       &kp AT                                          &kp PRCNT                                       &kp GRAVE                                       &kp COLON

/* Row 3 — home row */
/*  CAPS WORD                                       ---                                             ---                                             ---                                             ---                                             ---                                                                                                                                                                                                                                                                                                                                             ---                                             ()                                              )                                               +                                               =                                               ' */
    &caps_word                                      &trans                                          &trans                                          &trans                                          &trans                                          &kp G                                                                                                                                                                                                                                                                                                                                           &trans                                          &pair_paren                                     &kp RPAR                                        &kp PLUS                                        &kp EQUAL                                       &kp SQT

/* Row 4 — bottom row + inner columns */
/*  MAGIC                                           ---                                             ---                                             ---                                             ---                                             ---                                             ---                                             ---                                             ---                                             ---                                             ---                                             ---                                             ---                                             []                                              ]                                               !                                               ?                                               --- */
    &magic LAYER_Magic 0                            &trans                                          &trans                                          &trans                                          &trans                                          &trans                                          &trans                                          &trans                                          &trans                                          &trans                                          &trans                                          &trans                                          &trans                                          &pair_bracket                                   &kp RBKT                                        &kp EXCL                                        &kp QMARK                                       &trans

/* Row 5 — bottom mods + thumb cluster */
/*                                                  ---                                             ---                                             ---                                             ---                                             ---                                             TO BASE                                         ---                                             ---                                             ---                                             ---                                             ---                                             ---                                             ---                                             ---                                             ---                                             --- */
                                                    &trans                                          &trans                                          &trans                                          &trans                                          &trans                                          &to LAYER_Base                                  &trans                                          &trans                                          &trans                                          &trans                                          &trans                                          &trans                                          &trans                                          &trans                                          &trans                                          &trans

            >;
        };
