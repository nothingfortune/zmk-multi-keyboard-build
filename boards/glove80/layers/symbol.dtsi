/* glove80 — LAYER_Symbol (row-interleaved; shared positions synced from boards/go60/layers/symbol.dtsi) */

        LAYER_Symbol {
            bindings = <

/* Row 0 — function row */
/*                                                  ---                                             ---                                             ---                                             ---                                             ---                                                                                                                                                                                                                                                                                                                                             ---                                             ---                                             ---                                             ---                                             --- */
                                                    &trans                                          &trans                                          &trans                                          &trans                                          &trans                                                                                                                                                                                                                                                                                                                                          &trans                                          &trans                                          &trans                                          &trans                                          &trans

/* Row 1 — number row */
/*  ---                                             ---                                             ---                                             ---                                             ---                                             ---                                                                                                                                                                                                                                                                                                                                             ---                                             ---                                             ---                                             ---                                             ---                                             --- */
    &none                                           &none                                           &none                                           &none                                           &none                                           &none                                                                                                                                                                                                                                                                                                                                           &none                                           &none                                           &none                                           &none                                           &none                                           &none

/* Row 2 — top alpha row */
/*  ---                                             ~                                               $                                               #                                               ^                                               ---                                                                                                                                                                                                                                                                                                                                             ---                                             _                                               @                                               %                                               `                                               : */
    &none                                           &kp TILDE                                       &kp DOLLAR                                      &kp HASH                                        &kp CARET                                       &none                                                                                                                                                                                                                                                                                                                                           &none                                           &kp UNDER                                       &kp AT                                          &kp PRCNT                                       &kp GRAVE                                       &kp COLON

/* Row 3 — home row */
/*  CAPS WORD                                       -                                               *                                               |                                               &                                               ---                                                                                                                                                                                                                                                                                                                                             ---                                             ()                                              )                                               +                                               =                                               ' */
    &caps_word                                      &kp MINUS                                       &kp STAR                                        &kp PIPE                                        &kp AMPS                                        &none                                                                                                                                                                                                                                                                                                                                           &none                                           &pair_paren                                     &kp RPAR                                        &kp PLUS                                        &kp EQUAL                                       &kp SQT

/* Row 4 — bottom row + inner columns */
/*  MAGIC                                           {                                               }                                               <>                                              >                                               ---                                             ---                                             ---                                             ---                                             ---                                             ---                                             ---                                             ---                                             []                                              ]                                               !                                               ?                                               --- */
    &magic LAYER_Magic 0                            &pair_brace                                     &kp RBRC                                        &pair_angle                                     &kp GT                                          &none                                           &trans                                          &trans                                          &trans                                          &trans                                          &trans                                          &trans                                          &none                                           &pair_bracket                                   &kp RBKT                                        &kp EXCL                                        &kp QMARK                                       &trans

/* Row 5 — bottom mods + thumb cluster */
/*                                                  ---                                             ---                                             ---                                             ---                                             ---                                             TO BASE                                         ---                                             ---                                             ---                                             ---                                             ---                                             ---                                             ---                                             ---                                             ---                                             --- */
                                                    &trans                                          &trans                                          &trans                                          &trans                                          &trans                                          &to LAYER_Base                                  &trans                                          &trans                                          &trans                                          &trans                                          &trans                                          &trans                                          &trans                                          &trans                                          &trans                                          &trans

            >;
        };
