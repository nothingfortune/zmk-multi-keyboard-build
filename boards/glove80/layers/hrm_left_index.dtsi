/* glove80 — LAYER_LeftIndex (row-interleaved; shared positions synced from boards/go60/layers/hrm_left_index.dtsi) */

        LAYER_LeftIndex {
            bindings = <

/* ── Row 0 — function row (glove80-only) ───────────────────────────────────────────────────────────────────────────────────────────────────────────────────────────────────────────────────────────────────────────────────────────────────────────────────────────────────────────────────── */
/* │                 ---                  │ │                 ---                  │ │                 ---                  │ │                 ---                  │ │                 ---                  │                                        │                 ---                  │ │                 ---                  │ │                 ---                  │ │                 ---                  │ │                 ---                  │ */
/* |--------------------------------------| |--------------------------------------| |--------------------------------------| |--------------------------------------| |--------------------------------------|                                        |--------------------------------------| |--------------------------------------| |--------------------------------------| |--------------------------------------| |--------------------------------------| */

    &trans                                   &trans                                   &trans                                   &trans                                   &trans                                                                          &trans                                   &trans                                   &trans                                   &trans                                   &trans

/* ── Row 1 ─────────────────────────────────────────────────────────────────────────────────────────────────────────────────────────────────────────────────────────────────────────────────────────────────────────────────────────────────────────────────────────────────────────────────── */
/* │                 Esc                  │ │                  1                   │ │                  2                   │ │                  3                   │ │                  4                   │ │                  5                   │                                        │                  6                   │ │                  7                   │ │                  8                   │ │                  9                   │ │                  0                   │ │                  {}                  │ */
/* |--------------------------------------| |--------------------------------------| |--------------------------------------| |--------------------------------------| |--------------------------------------| |--------------------------------------|                                        |--------------------------------------| |--------------------------------------| |--------------------------------------| |--------------------------------------| |--------------------------------------| |--------------------------------------| */

    &HRM_left_index_tap_v1B_TKZ EQUAL                     &trans                                   &trans                                   &trans                                    &trans                                   &trans                                                                          &trans                                   &trans                                   &trans                                   &trans                                   &trans                                   &trans

/* ── Row 2 ─────────────────────────────────────────────────────────────────────────────────────────────────────────────────────────────────────────────────────────────────────────────────────────────────────────────────────────────────────────────────────────────────────────────────── */
/* │                 ---                  │ │                  Q                   │ │                  W                   │ │                  E                   │ │                  R                   │ │                  T                   │                                        │                  Y                   │ │                  U                   │ │                  I                   │ │                  O                   │ │                  P                   │ │                  \|                  │ */
/* |--------------------------------------| |--------------------------------------| |--------------------------------------| |--------------------------------------| |--------------------------------------| |--------------------------------------|                                        |--------------------------------------| |--------------------------------------| |--------------------------------------| |--------------------------------------| |--------------------------------------| |--------------------------------------| */

    &trans                                   &HRM_left_index_tap_v1B_TKZ Q            &HRM_left_index_tap_v1B_TKZ W            &HRM_left_index_tap_v1B_TKZ E            &HRM_left_index_tap_v1B_TKZ R            &HRM_left_index_tap_v1B_TKZ T                                                           &trans                                   &trans                                   &trans                                   &trans                                   &trans                                   &trans

/* ── Row 3 ─────────────────────────────────────────────────────────────────────────────────────────────────────────────────────────────────────────────────────────────────────────────────────────────────────────────────────────────────────────────────────────────────────────────────── */
/* │                 CAPS                 │ │                  A                   │ │                  S                   │ │                  D                   │ │                  F                   │ │                  G                   │                                        │                  H                   │ │                  J                   │ │                  K                   │ │                  L                   │ │                 SEMI                 │ │                QUOTE                 │ */
/* |--------------------------------------| |--------------------------------------| |--------------------------------------| |--------------------------------------| |--------------------------------------| |--------------------------------------|                                        |--------------------------------------| |--------------------------------------| |--------------------------------------| |--------------------------------------| |--------------------------------------| |--------------------------------------| */

    &trans                                   &HRM_left_index_pinky_v1B_TKZ LGUI A     &HRM_left_index_ring_v1B_TKZ LALT S      &HRM_left_index_middy_v1B_TKZ LCTRL D                 &none                                    &HRM_left_index_tap_v1B_TKZ G                                                           &trans                                   &kp J                                    &kp K                                    &kp L                                    &kp SEMI                                 &trans

/* ── Row 4 — bottom row + inner columns (52-57 glove80-only) ───────────────────────────────────────────────────────────────────────────────────────────────────────────────────────────────────────────────────────────────────────────────────────────────────────────────────────────────── */
/* │                MAGIC                 │ │                  Z                   │ │                  X                   │ │                  C                   │ │                  V                   │ │                  B                   │ │                 ---                  │ │                 ---                  │ │                 ---                  │ │                 ---                  │ │                 ---                  │ │                 ---                  │ │                  N                   │ │                  M                   │ │                COMMA                 │ │                 DOT                  │ │                QMARK                 │ │                LSHFT                 │ */
/* |--------------------------------------| |--------------------------------------| |--------------------------------------| |--------------------------------------| |--------------------------------------| |--------------------------------------| |--------------------------------------| |--------------------------------------| |--------------------------------------| |--------------------------------------| |--------------------------------------| |--------------------------------------| |--------------------------------------| |--------------------------------------| |--------------------------------------| |--------------------------------------| |--------------------------------------| |--------------------------------------| */

    &trans                                   &HRM_left_index_tap_v1B_TKZ Z            &HRM_left_index_tap_v1B_TKZ X            &HRM_left_index_tap_v1B_TKZ C            &HRM_left_index_tap_v1B_TKZ V            &HRM_left_index_tap_v1B_TKZ B                                                           &trans                                   &trans                                   &trans                                   &trans                                   &trans                                   &trans                                   &trans                                   &trans                                   &trans                                   &trans                                   &trans                                   &trans

/* ── Row 5 + thumb cluster (corners 64/68/75/79 glove80-only) ──────────────────────────────────────────────────────────────────────────────────────────────────────────────────────────────────────────────────────────────────────────────────────────────────────────────────────────────── */
/* │                 ---                  │ │                LCTRL                 │ │                 ---                  │ │                 ---                  │ │                 ---                  │ │                 ---                  │ │                 ---                  │ │                 ---                  │ │                 ---                  │ │                 ---                  │ │                 ---                  │ │                 ---                  │ │                 ---                  │ │                 ---                  │ │                 ---                  │ │                 ---                  │ */
/* |--------------------------------------| |--------------------------------------| |--------------------------------------| |--------------------------------------| |--------------------------------------| |--------------------------------------| |--------------------------------------| |--------------------------------------| |--------------------------------------| |--------------------------------------| |--------------------------------------| |--------------------------------------| |--------------------------------------| |--------------------------------------| |--------------------------------------| |--------------------------------------| */

    &trans                                   &trans                                   &trans                                   &trans                                                                                                                                                       &trans                                   &trans                                    &trans                                   &trans                                                                       &trans                                    &trans                                   &trans                                   &trans                                   &trans                                   &trans                                   &trans                                   &trans

            >;
        };
