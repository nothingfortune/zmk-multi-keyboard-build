/* glove80 — LAYER_RightMiddy (row-interleaved; shared positions synced from boards/go60/layers/hrm_right_middy.dtsi) */

        LAYER_RightMiddy {
            bindings = <

/* Row 0 — function row */
/*                                                  ---                                             ---                                             ---                                             ---                                             ---                                                                                                                                                                                                                                                                                                                                             ---                                             ---                                             ---                                             ---                                             --- */
                                                    &trans                                          &trans                                          &trans                                          &trans                                          &trans                                                                                                                                                                                                                                                                                                                                          &trans                                          &trans                                          &trans                                          &trans                                          &trans

/* Row 1 — number row */
/*  ---                                             1                                               2                                               3                                               4                                               5                                                                                                                                                                                                                                                                                                                                               6                                               7                                               8                                               9                                               0                                               {} */
    &trans                                          &trans                                          &trans                                          &trans                                          &trans                                          &trans                                                                                                                                                                                                                                                                                                                                          &trans                                          &trans                                          &trans                                          &trans                                          &trans                                          &trans

/* Row 2 — top alpha row */
/*  ---                                             Q                                               W                                               E                                               R                                               T                                                                                                                                                                                                                                                                                                                                               Y                                               U                                               I                                               O                                               P                                               \| */
    &trans                                          &trans                                          &trans                                          &trans                                          &trans                                          &trans                                                                                                                                                                                                                                                                                                                                          &HRM_right_middy_tap_v1B_TKZ Y                  &HRM_right_middy_tap_v1B_TKZ U                  &HRM_right_middy_tap_v1B_TKZ I                  &HRM_right_middy_tap_v1B_TKZ O                  &HRM_right_middy_tap_v1B_TKZ P                  &trans

/* Row 3 — home row */
/*  CAPS                                            A                                               S                                               D                                               F                                               G                                                                                                                                                                                                                                                                                                                                               H                                               J                                               K                                               L                                               SEMI                                            QUOTE */
    &trans                                          &kp A                                           &kp S                                           &kp D                                           &kp F                                           &trans                                                                                                                                                                                                                                                                                                                                          &HRM_right_middy_tap_v1B_TKZ H                  &HRM_right_middy_index_v1B_TKZ RSHFT J          &none                                           &HRM_right_middy_ring_v1B_TKZ LALT L            &HRM_right_middy_pinky_v1B_TKZ LGUI SEMI        &trans

/* Row 4 — bottom row + inner columns */
/*  MAGIC                                           Z                                               X                                               C                                               V                                               B                                               ---                                             ---                                             ---                                             ---                                             ---                                             ---                                             N                                               M                                               COMMA                                           DOT                                             QMARK                                           LSHFT */
    &trans                                          &trans                                          &trans                                          &trans                                          &trans                                          &trans                                          &trans                                          &trans                                          &trans                                          &trans                                          &trans                                          &trans                                          &HRM_right_middy_tap_v1B_TKZ N                  &HRM_right_middy_tap_v1B_TKZ M                  &HRM_right_middy_tap_v1B_TKZ COMMA              &HRM_right_middy_tap_v1B_TKZ DOT                &trans                                          &trans

/* Row 5 — bottom mods + thumb cluster */
/*                                                  ---                                             ---                                             ---                                             ---                                             ---                                             ---                                             ---                                             ---                                             ---                                             ---                                             ---                                             ---                                             ---                                             ---                                             ---                                             --- */
                                                    &trans                                          &trans                                          &trans                                          &trans                                          &trans                                          &trans                                          &trans                                          &trans                                          &trans                                          &trans                                          &trans                                          &trans                                          &trans                                          &trans                                          &trans                                          &trans

            >;
        };
