/* glove80 — LAYER_Keypad (row-interleaved; shared positions synced from boards/go60/layers/keypad.dtsi) */

        LAYER_Keypad {
            bindings = <

/* Row 0 — function row */
/*                                                  ---                                             ---                                             ---                                             ---                                             ---                                                                                                                                                                                                                                                                                                                                             ---                                             ---                                             ---                                             ---                                             --- */
                                                    &trans                                          &trans                                          &trans                                          &trans                                          &trans                                                                                                                                                                                                                                                                                                                                          &trans                                          &trans                                          &trans                                          &trans                                          &trans

/* Row 1 — number row */
/*  F1                                              F2                                              F3                                              F4                                              F5                                              F6                                                                                                                                                                                                                                                                                                                                              F7                                              F8                                              F9                                              F10                                             F11                                             F12 */
    &kp F1                                          &kp F2                                          &kp F3                                          &kp F4                                          &kp F5                                          &kp F6                                                                                                                                                                                                                                                                                                                                          &kp F7                                          &kp F8                                          &kp F9                                          &kp F10                                         &kp F11                                         &kp F12

/* Row 2 — top alpha row */
/*  TAB                                             *                                               7                                               8                                               9                                               /                                                                                                                                                                                                                                                                                                                                               /                                               7                                               8                                               9                                               STAR                                            --- */
    &kp TAB                                         &kp STAR                                        &kp N7                                          &kp N8                                          &kp N9                                          &kp SLASH                                                                                                                                                                                                                                                                                                                                       &kp SLASH                                       &kp N7                                          &kp N8                                          &kp N9                                          &kp STAR                                        &trans

/* Row 3 — home row */
/*  ---                                             -                                               4                                               5                                               6                                               +                                                                                                                                                                                                                                                                                                                                               +                                               4                                               5                                               6                                               +                                               --- */
    &none                                           &kp MINUS                                       &kp N4                                          &kp N5                                          &kp N6                                          &kp PLUS                                                                                                                                                                                                                                                                                                                                        &kp PLUS                                        &kp N4                                          &kp N5                                          &kp N6                                          &kp PLUS                                        &trans

/* Row 4 — bottom row + inner columns */
/*  MAGIC                                           =                                               1                                               2                                               3                                               -                                               ---                                             ---                                             ---                                             ---                                             ---                                             ---                                             -                                               1                                               2                                               3                                               =                                               DEL */
    &magic LAYER_Magic 0                            &kp EQUAL                                       &kp N1                                          &kp N2                                          &kp N3                                          &kp MINUS                                       &trans                                          &trans                                          &trans                                          &trans                                          &trans                                          &trans                                          &kp MINUS                                       &kp N1                                          &kp N2                                          &kp N3                                          &kp ENTER                                       &kp DEL

/* Row 5 — bottom mods + thumb cluster */
/*                                                  ---                                             ENTER                                           .                                               0                                               ---                                             NAV(hold)/SPACE                                 ---                                             ---                                             ---                                             ---                                             ---                                             ---                                             N0                                              .                                               RETURN                                          --- */
                                                    &trans                                          &kp RET                                         &kp DOT                                         &kp N0                                          &trans                                          &mo LAYER_Symbol                                &trans                                          &trans                                          &trans                                          &trans                                          &trans                                          &trans                                          &kp N0                                          &kp DOT                                         &kp RET                                         &trans

            >;
        };
