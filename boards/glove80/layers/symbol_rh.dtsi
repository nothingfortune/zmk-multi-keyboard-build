/* glove80 — LAYER_Symbol_rh (row-interleaved; shared positions synced from boards/go60/layers/symbol_rh.dtsi) */

        LAYER_Symbol_rh {
            bindings = <

/* Row 0 — function row */
/*                                                  ---                                             ---                                             ---                                             ---                                             ---                                                                                                                                                                                                                                                                                                                                             ---                                             ---                                             ---                                             ---                                             --- */
                                                    &trans                                          &trans                                          &trans                                          &trans                                          &trans                                                                                                                                                                                                                                                                                                                                          &trans                                          &trans                                          &trans                                          &trans                                          &trans

/* Row 1 — number row */
/*  ---                                             ---                                             ---                                             ---                                             ---                                             ---                                                                                                                                                                                                                                                                                                                                             ---                                             ---                                             ---                                             ---                                             ---                                             --- */
    &trans                                          &trans                                          &trans                                          &trans                                          &trans                                          &trans                                                                                                                                                                                                                                                                                                                                          &trans                                          &trans                                          &trans                                          &trans                                          &trans                                          &trans

/* Row 2 — top alpha row */
/*  ---                                             ~                                               $                                               #                                               ^                                               ---                                                                                                                                                                                                                                                                                                                                             ---                                             ---                                             ---                                             ---                                             ---                                             --- */
    &trans                                          &kp TILDE                                       &kp DOLLAR                                      &kp HASH                                        &kp CARET                                       &trans                                                                                                                                                                                                                                                                                                                                          &trans                                          &trans                                          &trans                                          &trans                                          &trans                                          &trans

/* Row 3 — home row */
/*  CAPS WORD                                       -                                               *                                               |                                               &                                               ---                                                                                                                                                                                                                                                                                                                                             ---                                             ---                                             ---                                             ---                                             ---                                             --- */
    &caps_word                                      &kp MINUS                                       &kp STAR                                        &kp PIPE                                        &kp AMPS                                        &trans                                                                                                                                                                                                                                                                                                                                          &kp H                                           &trans                                          &trans                                          &trans                                          &trans                                          &trans

/* Row 4 — bottom row + inner columns */
/*  MAGIC                                           {                                               }                                               <>                                              >                                               ---                                             ---                                             ---                                             ---                                             ---                                             ---                                             ---                                             ---                                             ---                                             ---                                             ---                                             ---                                             --- */
    &magic LAYER_Magic 0                            &pair_brace                                     &kp RBRC                                        &pair_angle                                     &kp GT                                          &trans                                          &trans                                          &trans                                          &trans                                          &trans                                          &trans                                          &trans                                          &trans                                          &trans                                          &trans                                          &trans                                          &trans                                          &trans

/* Row 5 — bottom mods + thumb cluster */
/*                                                  ---                                             ---                                             ---                                             ---                                             ---                                             TO BASE                                         ---                                             ---                                             ---                                             ---                                             ---                                             ---                                             ---                                             ---                                             ---                                             --- */
                                                    &trans                                          &trans                                          &trans                                          &trans                                          &trans                                          &to LAYER_Base                                  &trans                                          &trans                                          &trans                                          &trans                                          &trans                                          &trans                                          &trans                                          &trans                                          &trans                                          &trans

            >;
        };
