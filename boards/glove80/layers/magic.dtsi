/* glove80 — LAYER_Magic (row-interleaved; shared positions synced from boards/go60/layers/magic.dtsi) */

        LAYER_Magic {
            bindings = <

/* Row 0 — function row */
/*                                                  ---                                             ---                                             ---                                             ---                                             ---                                                                                                                                                                                                                                                                                                                                             ---                                             ---                                             ---                                             ---                                             --- */
                                                    &trans                                          &trans                                          &trans                                          &trans                                          &trans                                                                                                                                                                                                                                                                                                                                          &trans                                          &trans                                          &trans                                          &trans                                          &trans

/* Row 1 — number row */
/*  ---                                             ---                                             ---                                             ---                                             ---                                             ---                                                                                                                                                                                                                                                                                                                                             ---                                             ---                                             ---                                             ---                                             ---                                             --- */
    &trans                                          &kp C_BRI_DN                                    &kp C_BRI_UP                                    &kp C_PREV                                      &kp C_NEXT                                      &kp C_PP                                                                                                                                                                                                                                                                                                                                        &kp C_MUTE                                      &kp C_VOL_DN                                    &kp C_VOL_UP                                    &trans                                          &bt BT_CLR                                      &bt BT_CLR

/* Row 2 — top alpha row */
/*  ---                                             ---                                             ---                                             ---                                             ---                                             ---                                                                                                                                                                                                                                                                                                                                             ---                                             ---                                             ---                                             ---                                             ---                                             --- */
    &bootloader                                     &rgb_ug RGB_SPI                                 &rgb_ug RGB_SAI                                 &rgb_ug RGB_HUI                                 &rgb_ug RGB_BRI                                 &rgb_ug RGB_TOG                                                                                                                                                                                                                                                                                                                                 &none                                           &none                                           &none                                           &none                                           &none                                           &bootloader

/* Row 3 — home row */
/*  ---                                             GUI(hold)/A                                     ---                                             ---                                             ---                                             ---                                                                                                                                                                                                                                                                                                                                             ---                                             ---                                             ---                                             ---                                             ---                                             --- */
    &sys_reset                                      &rgb_ug RGB_SPD                                 &rgb_ug RGB_SAD                                 &rgb_ug RGB_HUD                                 &rgb_ug RGB_BRD                                 &rgb_ug RGB_EFF                                                                                                                                                                                                                                                                                                                                 &none                                           &none                                           &none                                           &none                                           &none                                           &sys_reset

/* Row 4 — bottom row + inner columns */
/*  MAGIC                                           Z                                               ---                                             ---                                             ---                                             ---                                             ---                                             ---                                             ---                                             ---                                             ---                                             ---                                             ---                                             ---                                             ---                                             ---                                             ---                                             --- */
    &none                                           &none                                           &bt_0                                           &bt_1                                           &bt_2                                           &bt_3                                           &trans                                          &trans                                          &trans                                          &trans                                          &trans                                          &trans                                          &none                                           &none                                           &none                                           &none                                           &none                                           &trans

/* Row 5 — bottom mods + thumb cluster */
/*                                                  ---                                             USB Priority                                    ---                                             ---                                             ---                                             ---                                             ---                                             ---                                             Prev Tab                                        ---                                             Next Tab                                        ---                                             ---                                             ---                                             ---                                             --- */
                                                    &trans                                          &out OUT_USB                                    &none                                           &to LAYER_Typing                                &trans                                          &trans                                          &trans                                          &trans                                          &mac_tab_prev                                   &trans                                          &mac_tab_next                                   &trans                                          &trans                                          &trans                                          &trans                                          &trans

            >;
        };
