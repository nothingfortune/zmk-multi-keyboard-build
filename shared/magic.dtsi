/* RGB status macro — used by the magic hold-tap below */
rgb_ug_status_macro: rgb_ug_status_macro {
    label = "RGB_UG_STATUS";
    compatible = "zmk,behavior-macro";
    #binding-cells = <0>;
    bindings = <&rgb_ug RGB_STATUS>;
};

magic: magic {
    compatible = "zmk,behavior-hold-tap";
    label = "MAGIC_HOLD_TAP";
    #binding-cells = <2>;
    flavor = "hold-preferred";
    tapping-term-ms = <TD_TAPPING_TERM>;
    bindings = <&mo>, <&rgb_ug_status_macro>;
};